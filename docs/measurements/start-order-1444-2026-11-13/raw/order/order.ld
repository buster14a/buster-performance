SECTIONS
{
    .text.buster_start :
    {
        */main.c.o(.text.tokenize_with_flags .text.unlikely.tokenize_with_flags)
        */main/native.o(.text.tokenize_with_flags .text.unlikely.tokenize_with_flags)
        */main.c.o(.text.c_tokenize .text.unlikely.c_tokenize)
        */main/native.o(.text.c_tokenize .text.unlikely.c_tokenize)
        */main.c.o(.text.lane_threads_report .text.unlikely.lane_threads_report)
        */main/native.o(.text.lane_threads_report .text.unlikely.lane_threads_report)
        */main.c.o(.text.main_information .text.unlikely.main_information)
        */main/native.o(.text.main_information .text.unlikely.main_information)
        */main.c.o(.text.main_preprocessing .text.unlikely.main_preprocessing)
        */main/native.o(.text.main_preprocessing .text.unlikely.main_preprocessing)
        */main.c.o(.text.__wrap___register_frame_info .text.unlikely.__wrap___register_frame_info)
        */main/native.o(.text.__wrap___register_frame_info .text.unlikely.__wrap___register_frame_info)
        */main.c.o(.text.main .text.unlikely.main)
        */main/native.o(.text.main .text.unlikely.main)
        */main.c.o(.text.tokenize_c_raw_no_separators .text.unlikely.tokenize_c_raw_no_separators)
        */main/native.o(.text.tokenize_c_raw_no_separators .text.unlikely.tokenize_c_raw_no_separators)
        */main.c.o(.text.write_chunk_outlined .text.unlikely.write_chunk_outlined)
        */main/native.o(.text.write_chunk_outlined .text.unlikely.write_chunk_outlined)
        */main.c.o(.text.main_source_command .text.unlikely.main_source_command)
        */main/native.o(.text.main_source_command .text.unlikely.main_source_command)
        */main_unit_frontend.c.o(.text.pp_diagnostic_summary .text.unlikely.pp_diagnostic_summary)
        */main_unit_frontend/native.o(.text.pp_diagnostic_summary .text.unlikely.pp_diagnostic_summary)
        */main_unit_frontend.c.o(.text.pp_diagnostic_warning_visible .text.unlikely.pp_diagnostic_warning_visible)
        */main_unit_frontend/native.o(.text.pp_diagnostic_warning_visible .text.unlikely.pp_diagnostic_warning_visible)
        */main_unit_frontend.c.o(.text.pp_diagnostic_publish .text.unlikely.pp_diagnostic_publish)
        */main_unit_frontend/native.o(.text.pp_diagnostic_publish .text.unlikely.pp_diagnostic_publish)
        */main_unit_frontend.c.o(.text.pp_location_in_main_file .text.unlikely.pp_location_in_main_file)
        */main_unit_frontend/native.o(.text.pp_location_in_main_file .text.unlikely.pp_location_in_main_file)
        */main_unit_frontend.c.o(.text.pp_initialize .text.unlikely.pp_initialize)
        */main_unit_frontend/native.o(.text.pp_initialize .text.unlikely.pp_initialize)
        */main_unit_frontend.c.o(.text.pp_initialize_once .text.unlikely.pp_initialize_once)
        */main_unit_frontend/native.o(.text.pp_initialize_once .text.unlikely.pp_initialize_once)
        */main_unit_frontend.c.o(.text.pp_release_file_columns .text.unlikely.pp_release_file_columns)
        */main_unit_frontend/native.o(.text.pp_release_file_columns .text.unlikely.pp_release_file_columns)
        */main_unit_frontend.c.o(.text.pp_release_output .text.unlikely.pp_release_output)
        */main_unit_frontend/native.o(.text.pp_release_output .text.unlikely.pp_release_output)
        */main_unit_frontend.c.o(.text.arena_release .text.unlikely.arena_release)
        */main_unit_frontend/native.o(.text.arena_release .text.unlikely.arena_release)
        */main_unit_frontend.c.o(.text.pp_preprocess_file .text.unlikely.pp_preprocess_file)
        */main_unit_frontend/native.o(.text.pp_preprocess_file .text.unlikely.pp_preprocess_file)
        */main_unit_frontend.c.o(.text.pp_run_input .text.unlikely.pp_run_input)
        */main_unit_frontend/native.o(.text.pp_run_input .text.unlikely.pp_run_input)
        */main_unit_frontend.c.o(.text.driver_read_nonregular .text.unlikely.driver_read_nonregular)
        */main_unit_frontend/native.o(.text.driver_read_nonregular .text.unlikely.driver_read_nonregular)
        */main_unit_frontend.c.o(.text.pp_print_vector .text.unlikely.pp_print_vector)
        */main_unit_frontend/native.o(.text.pp_print_vector .text.unlikely.pp_print_vector)
        */main_unit_frontend.c.o(.text.pp_parse_options .text.unlikely.pp_parse_options)
        */main_unit_frontend/native.o(.text.pp_parse_options .text.unlikely.pp_parse_options)
        */main_unit_frontend.c.o(.text.pp_parse_options_inputs .text.unlikely.pp_parse_options_inputs)
        */main_unit_frontend/native.o(.text.pp_parse_options_inputs .text.unlikely.pp_parse_options_inputs)
        */main_unit_frontend.c.o(.text.parse_initialize .text.unlikely.parse_initialize)
        */main_unit_frontend/native.o(.text.parse_initialize .text.unlikely.parse_initialize)
        */main_unit_frontend.c.o(.text.parse_translation_unit .text.unlikely.parse_translation_unit)
        */main_unit_frontend/native.o(.text.parse_translation_unit .text.unlikely.parse_translation_unit)
        */main_unit_frontend.c.o(.text.parse_columns .text.unlikely.parse_columns)
        */main_unit_frontend/native.o(.text.parse_columns .text.unlikely.parse_columns)
        */main_unit_frontend.c.o(.text.parse_tokens_from_output .text.unlikely.parse_tokens_from_output)
        */main_unit_frontend/native.o(.text.parse_tokens_from_output .text.unlikely.parse_tokens_from_output)
        */main_unit_frontend.c.o(.text.parse_prepare_meanings .text.unlikely.parse_prepare_meanings)
        */main_unit_frontend/native.o(.text.parse_prepare_meanings .text.unlikely.parse_prepare_meanings)
        */main_unit_frontend.c.o(.text.parse_kernels_reserve_tree .text.unlikely.parse_kernels_reserve_tree)
        */main_unit_frontend/native.o(.text.parse_kernels_reserve_tree .text.unlikely.parse_kernels_reserve_tree)
        */main_unit_frontend.c.o(.text.parse_vector_buffers_reserve .text.unlikely.parse_vector_buffers_reserve)
        */main_unit_frontend/native.o(.text.parse_vector_buffers_reserve .text.unlikely.parse_vector_buffers_reserve)
        */main_unit_frontend.c.o(.text.main_preprocessor_command .text.unlikely.main_preprocessor_command)
        */main_unit_frontend/native.o(.text.main_preprocessor_command .text.unlikely.main_preprocessor_command)
        */main_unit_frontend.c.o(.text.run_preprocessor_command_mode .text.unlikely.run_preprocessor_command_mode)
        */main_unit_frontend/native.o(.text.run_preprocessor_command_mode .text.unlikely.run_preprocessor_command_mode)
        */main_unit_frontend.c.o(.text.arena_reserve_small .text.unlikely.arena_reserve_small)
        */main_unit_frontend/native.o(.text.arena_reserve_small .text.unlikely.arena_reserve_small)
        */main_unit_frontend.c.o(.text.pp_warning_flag .text.unlikely.pp_warning_flag)
        */main_unit_frontend/native.o(.text.pp_warning_flag .text.unlikely.pp_warning_flag)
        */main_unit_frontend.c.o(.text.arena_reserve_tables .text.unlikely.arena_reserve_tables)
        */main_unit_frontend/native.o(.text.arena_reserve_tables .text.unlikely.arena_reserve_tables)
        */main_unit_frontend.c.o(.text.pp_add_directory .text.unlikely.pp_add_directory)
        */main_unit_frontend/native.o(.text.pp_add_directory .text.unlikely.pp_add_directory)
        */main_unit_frontend.c.o(.text.pp_clang_resource_directory .text.unlikely.pp_clang_resource_directory)
        */main_unit_frontend/native.o(.text.pp_clang_resource_directory .text.unlikely.pp_clang_resource_directory)
        */main_unit_frontend.c.o(.text.intern_find_or_add .text.unlikely.intern_find_or_add)
        */main_unit_frontend/native.o(.text.intern_find_or_add .text.unlikely.intern_find_or_add)
        */main_unit_frontend.c.o(.text.pp_set_macro .text.unlikely.pp_set_macro)
        */main_unit_frontend/native.o(.text.pp_set_macro .text.unlikely.pp_set_macro)
        */main_unit_frontend.c.o(.text.intern_lay_out .text.unlikely.intern_lay_out)
        */main_unit_frontend/native.o(.text.intern_lay_out .text.unlikely.intern_lay_out)
        */main_unit_frontend.c.o(.text.pp_scratch_in .text.unlikely.pp_scratch_in)
        */main_unit_frontend/native.o(.text.pp_scratch_in .text.unlikely.pp_scratch_in)
        */main_unit_frontend.c.o(.text.arena_commit .text.unlikely.arena_commit)
        */main_unit_frontend/native.o(.text.arena_commit .text.unlikely.arena_commit)
        */main_unit_frontend.c.o(.text.pp_run_prelude .text.unlikely.pp_run_prelude)
        */main_unit_frontend/native.o(.text.pp_run_prelude .text.unlikely.pp_run_prelude)
        */main_unit_frontend.c.o(.text.pp_lookup_path .text.unlikely.pp_lookup_path)
        */main_unit_frontend/native.o(.text.pp_lookup_path .text.unlikely.pp_lookup_path)
        */main_unit_frontend.c.o(.text.pp_run_main .text.unlikely.pp_run_main)
        */main_unit_frontend/native.o(.text.pp_run_main .text.unlikely.pp_run_main)
        */main_unit_frontend.c.o(.text.pp_run_file .text.unlikely.pp_run_file)
        */main_unit_frontend/native.o(.text.pp_run_file .text.unlikely.pp_run_file)
        */main_unit_frontend.c.o(.text.pp_predefines .text.unlikely.pp_predefines)
        */main_unit_frontend/native.o(.text.pp_predefines .text.unlikely.pp_predefines)
        */main_unit_frontend.c.o(.text.pp_virtual_file .text.unlikely.pp_virtual_file)
        */main_unit_frontend/native.o(.text.pp_virtual_file .text.unlikely.pp_virtual_file)
        */main_unit_frontend.c.o(.text.predefines_host_of .text.unlikely.predefines_host_of)
        */main_unit_frontend/native.o(.text.predefines_host_of .text.unlikely.predefines_host_of)
        */main_unit_frontend.c.o(.text.predefines_apply .text.unlikely.predefines_apply)
        */main_unit_frontend/native.o(.text.predefines_apply .text.unlikely.predefines_apply)
        */main_unit_frontend.c.o(.text.pp_enter_file .text.unlikely.pp_enter_file)
        */main_unit_frontend/native.o(.text.pp_enter_file .text.unlikely.pp_enter_file)
        */main_unit_frontend.c.o(.text.pp_run_contexts .text.unlikely.pp_run_contexts)
        */main_unit_frontend/native.o(.text.pp_run_contexts .text.unlikely.pp_run_contexts)
        */main_unit_frontend.c.o(.text.pp_dependency_observe .text.unlikely.pp_dependency_observe)
        */main_unit_frontend/native.o(.text.pp_dependency_observe .text.unlikely.pp_dependency_observe)
        */main_unit_frontend.c.o(.text.pp_prepare_data .text.unlikely.pp_prepare_data)
        */main_unit_frontend/native.o(.text.pp_prepare_data .text.unlikely.pp_prepare_data)
        */main_unit_frontend.c.o(.text.pp_note_system_run .text.unlikely.pp_note_system_run)
        */main_unit_frontend/native.o(.text.pp_note_system_run .text.unlikely.pp_note_system_run)
        */main_unit_frontend.c.o(.text.pp_prepare_into .text.unlikely.pp_prepare_into)
        */main_unit_frontend/native.o(.text.pp_prepare_into .text.unlikely.pp_prepare_into)
        */main_unit_frontend.c.o(.text.pp_prepare_whole .text.unlikely.pp_prepare_whole)
        */main_unit_frontend/native.o(.text.pp_prepare_whole .text.unlikely.pp_prepare_whole)
        */main_unit_frontend.c.o(.text.pp_lex_for_mode .text.unlikely.pp_lex_for_mode)
        */main_unit_frontend/native.o(.text.pp_lex_for_mode .text.unlikely.pp_lex_for_mode)
        */main_unit_frontend.c.o(.text.pp_scan_named_ucn_chunks .text.unlikely.pp_scan_named_ucn_chunks)
        */main_unit_frontend/native.o(.text.pp_scan_named_ucn_chunks .text.unlikely.pp_scan_named_ucn_chunks)
        */main_unit_frontend.c.o(.text.pp_record_raw_errors .text.unlikely.pp_record_raw_errors)
        */main_unit_frontend/native.o(.text.pp_record_raw_errors .text.unlikely.pp_record_raw_errors)
        */main_unit_frontend.c.o(.text.pp_record_named_ucns .text.unlikely.pp_record_named_ucns)
        */main_unit_frontend/native.o(.text.pp_record_named_ucns .text.unlikely.pp_record_named_ucns)
        */main_unit_frontend.c.o(.text.refine_pass_b_64_plain .text.unlikely.refine_pass_b_64_plain)
        */main_unit_frontend/native.o(.text.refine_pass_b_64_plain .text.unlikely.refine_pass_b_64_plain)
        */main_unit_frontend.c.o(.text.refine_step_splices .text.unlikely.refine_step_splices)
        */main_unit_frontend/native.o(.text.refine_step_splices .text.unlikely.refine_step_splices)
        */main_unit_frontend.c.o(.text.pp_directive_arrays .text.unlikely.pp_directive_arrays)
        */main_unit_frontend/native.o(.text.pp_directive_arrays .text.unlikely.pp_directive_arrays)
        */main_unit_frontend.c.o(.text.pp_finish_directives .text.unlikely.pp_finish_directives)
        */main_unit_frontend/native.o(.text.pp_finish_directives .text.unlikely.pp_finish_directives)
        */main_unit_frontend.c.o(.text.pp_find_guard .text.unlikely.pp_find_guard)
        */main_unit_frontend/native.o(.text.pp_find_guard .text.unlikely.pp_find_guard)
        */main_unit_frontend.c.o(.text.refine_tokens_chunks_plain .text.unlikely.refine_tokens_chunks_plain)
        */main_unit_frontend/native.o(.text.refine_tokens_chunks_plain .text.unlikely.refine_tokens_chunks_plain)
        */main_unit_frontend.c.o(.text.file_cache_arenas .text.unlikely.file_cache_arenas)
        */main_unit_frontend/native.o(.text.file_cache_arenas .text.unlikely.file_cache_arenas)
        */main_unit_frontend.c.o(.text.pp_finish_capture .text.unlikely.pp_finish_capture)
        */main_unit_frontend/native.o(.text.pp_finish_capture .text.unlikely.pp_finish_capture)
        */main_unit_frontend.c.o(.text.pp_collect_token .text.unlikely.pp_collect_token)
        */main_unit_frontend/native.o(.text.pp_collect_token .text.unlikely.pp_collect_token)
        */main_unit_frontend.c.o(.text.pp_directive .text.unlikely.pp_directive)
        */main_unit_frontend/native.o(.text.pp_directive .text.unlikely.pp_directive)
        */main_unit_frontend.c.o(.text.pp_close_invocation .text.unlikely.pp_close_invocation)
        */main_unit_frontend/native.o(.text.pp_close_invocation .text.unlikely.pp_close_invocation)
        */main_unit_frontend.c.o(.text.pp_start_with_splices .text.unlikely.pp_start_with_splices)
        */main_unit_frontend/native.o(.text.pp_start_with_splices .text.unlikely.pp_start_with_splices)
        */main_unit_frontend.c.o(.text.pp_history_fill .text.unlikely.pp_history_fill)
        */main_unit_frontend/native.o(.text.pp_history_fill .text.unlikely.pp_history_fill)
        */main_unit_frontend.c.o(.text.pp_prepared_directive .text.unlikely.pp_prepared_directive)
        */main_unit_frontend/native.o(.text.pp_prepared_directive .text.unlikely.pp_prepared_directive)
        */main_unit_frontend.c.o(.text.pp_query_raw_overlap .text.unlikely.pp_query_raw_overlap)
        */main_unit_frontend/native.o(.text.pp_query_raw_overlap .text.unlikely.pp_query_raw_overlap)
        */main_unit_frontend.c.o(.text.pp_scan_header_bytes .text.unlikely.pp_scan_header_bytes)
        */main_unit_frontend/native.o(.text.pp_scan_header_bytes .text.unlikely.pp_scan_header_bytes)
        */main_unit_frontend.c.o(.text.pp_recover_header_comment .text.unlikely.pp_recover_header_comment)
        */main_unit_frontend/native.o(.text.pp_recover_header_comment .text.unlikely.pp_recover_header_comment)
        */main_unit_frontend.c.o(.text.pp_skip_comment .text.unlikely.pp_skip_comment)
        */main_unit_frontend/native.o(.text.pp_skip_comment .text.unlikely.pp_skip_comment)
        */main_unit_frontend.c.o(.text.pp_define_location .text.unlikely.pp_define_location)
        */main_unit_frontend/native.o(.text.pp_define_location .text.unlikely.pp_define_location)
        */main_unit_frontend.c.o(.text.pp_reserved_macro_name .text.unlikely.pp_reserved_macro_name)
        */main_unit_frontend/native.o(.text.pp_reserved_macro_name .text.unlikely.pp_reserved_macro_name)
        */main_unit_frontend.c.o(.text.pp_language_defined .text.unlikely.pp_language_defined)
        */main_unit_frontend/native.o(.text.pp_language_defined .text.unlikely.pp_language_defined)
        */main_unit_frontend.c.o(.text.pp_line_end_location .text.unlikely.pp_line_end_location)
        */main_unit_frontend/native.o(.text.pp_line_end_location .text.unlikely.pp_line_end_location)
        */main_unit_frontend.c.o(.text.pp_copy_line .text.unlikely.pp_copy_line)
        */main_unit_frontend/native.o(.text.pp_copy_line .text.unlikely.pp_copy_line)
        */main_unit_frontend.c.o(.text.pp_pragma .text.unlikely.pp_pragma)
        */main_unit_frontend/native.o(.text.pp_pragma .text.unlikely.pp_pragma)
        */main_unit_frontend.c.o(.text.pp_scan_body_vector .text.unlikely.pp_scan_body_vector)
        */main_unit_frontend/native.o(.text.pp_scan_body_vector .text.unlikely.pp_scan_body_vector)
        */main_unit_frontend.c.o(.text.pp_check_replacement_list .text.unlikely.pp_check_replacement_list)
        */main_unit_frontend/native.o(.text.pp_check_replacement_list .text.unlikely.pp_check_replacement_list)
        */main_unit_frontend.c.o(.text.pp_same_definition .text.unlikely.pp_same_definition)
        */main_unit_frontend/native.o(.text.pp_same_definition .text.unlikely.pp_same_definition)
        */main_unit_frontend.c.o(.text.pp_same_file_token .text.unlikely.pp_same_file_token)
        */main_unit_frontend/native.o(.text.pp_same_file_token .text.unlikely.pp_same_file_token)
        */main_unit_frontend.c.o(.text.pp_remove_splices_by .text.unlikely.pp_remove_splices_by)
        */main_unit_frontend/native.o(.text.pp_remove_splices_by .text.unlikely.pp_remove_splices_by)
        */main_unit_frontend.c.o(.text.pp_literal_header_name .text.unlikely.pp_literal_header_name)
        */main_unit_frontend/native.o(.text.pp_literal_header_name .text.unlikely.pp_literal_header_name)
        */main_unit_frontend.c.o(.text.pp_header_name_tail .text.unlikely.pp_header_name_tail)
        */main_unit_frontend/native.o(.text.pp_header_name_tail .text.unlikely.pp_header_name_tail)
        */main_unit_frontend.c.o(.text.pp_include_file .text.unlikely.pp_include_file)
        */main_unit_frontend/native.o(.text.pp_include_file .text.unlikely.pp_include_file)
        */main_unit_frontend.c.o(.text.pp_find_include .text.unlikely.pp_find_include)
        */main_unit_frontend/native.o(.text.pp_find_include .text.unlikely.pp_find_include)
        */main_unit_frontend.c.o(.text.pp_start_condition .text.unlikely.pp_start_condition)
        */main_unit_frontend/native.o(.text.pp_start_condition .text.unlikely.pp_start_condition)
        */main_unit_frontend.c.o(.text.pp_skip_group .text.unlikely.pp_skip_group)
        */main_unit_frontend/native.o(.text.pp_skip_group .text.unlikely.pp_skip_group)
        */main_unit_frontend.c.o(.text.pp_history_expansion .text.unlikely.pp_history_expansion)
        */main_unit_frontend/native.o(.text.pp_history_expansion .text.unlikely.pp_history_expansion)
        */main_unit_frontend.c.o(.text.pp_evaluate_value .text.unlikely.pp_evaluate_value)
        */main_unit_frontend/native.o(.text.pp_evaluate_value .text.unlikely.pp_evaluate_value)
        */main_unit_frontend.c.o(.text.pp_spelling .text.unlikely.pp_spelling)
        */main_unit_frontend/native.o(.text.pp_spelling .text.unlikely.pp_spelling)
        */main_unit_frontend.c.o(.text.pp_reduce .text.unlikely.pp_reduce)
        */main_unit_frontend/native.o(.text.pp_reduce .text.unlikely.pp_reduce)
        */main_unit_frontend.c.o(.text.pp_pragma_run .text.unlikely.pp_pragma_run)
        */main_unit_frontend/native.o(.text.pp_pragma_run .text.unlikely.pp_pragma_run)
        */main_unit_frontend.c.o(.text.pp_header_name .text.unlikely.pp_header_name)
        */main_unit_frontend/native.o(.text.pp_header_name .text.unlikely.pp_header_name)
        */main_unit_frontend.c.o(.text.pp_feature .text.unlikely.pp_feature)
        */main_unit_frontend/native.o(.text.pp_feature .text.unlikely.pp_feature)
        */main_unit_frontend.c.o(.text.cbuiltin_source_scope .text.unlikely.cbuiltin_source_scope)
        */main_unit_frontend/native.o(.text.cbuiltin_source_scope .text.unlikely.cbuiltin_source_scope)
        */main_unit_frontend.c.o(.text.cbuiltin_has_capability .text.unlikely.cbuiltin_has_capability)
        */main_unit_frontend/native.o(.text.cbuiltin_has_capability .text.unlikely.cbuiltin_has_capability)
        */main_unit_frontend.c.o(.text.cbuiltin_source_intrinsic .text.unlikely.cbuiltin_source_intrinsic)
        */main_unit_frontend/native.o(.text.cbuiltin_source_intrinsic .text.unlikely.cbuiltin_source_intrinsic)
        */main_unit_frontend.c.o(.text.pp_library_builtin .text.unlikely.pp_library_builtin)
        */main_unit_frontend/native.o(.text.pp_library_builtin .text.unlikely.pp_library_builtin)
        */main_unit_frontend.c.o(.text.cbuiltin_resolve .text.unlikely.cbuiltin_resolve)
        */main_unit_frontend/native.o(.text.cbuiltin_resolve .text.unlikely.cbuiltin_resolve)
        */main_unit_frontend.c.o(.text.pp_continue_invocation .text.unlikely.pp_continue_invocation)
        */main_unit_frontend/native.o(.text.pp_continue_invocation .text.unlikely.pp_continue_invocation)
        */main_unit_frontend.c.o(.text.pp_builtin_value .text.unlikely.pp_builtin_value)
        */main_unit_frontend/native.o(.text.pp_builtin_value .text.unlikely.pp_builtin_value)
        */main_unit_frontend.c.o(.text.pp_feature_token .text.unlikely.pp_feature_token)
        */main_unit_frontend/native.o(.text.pp_feature_token .text.unlikely.pp_feature_token)
        */main_unit_frontend.c.o(.text.pp_substitute .text.unlikely.pp_substitute)
        */main_unit_frontend/native.o(.text.pp_substitute .text.unlikely.pp_substitute)
        */main_unit_frontend.c.o(.text.pp_stringize .text.unlikely.pp_stringize)
        */main_unit_frontend/native.o(.text.pp_stringize .text.unlikely.pp_stringize)
        */main_unit_frontend.c.o(.text.pp_append_tokens .text.unlikely.pp_append_tokens)
        */main_unit_frontend/native.o(.text.pp_append_tokens .text.unlikely.pp_append_tokens)
        */main_unit_frontend.c.o(.text.pp_expand_current .text.unlikely.pp_expand_current)
        */main_unit_frontend/native.o(.text.pp_expand_current .text.unlikely.pp_expand_current)
        */main_unit_frontend.c.o(.text.pp_compile_macro .text.unlikely.pp_compile_macro)
        */main_unit_frontend/native.o(.text.pp_compile_macro .text.unlikely.pp_compile_macro)
        */main_unit_frontend.c.o(.text.pp_emit_simple_names .text.unlikely.pp_emit_simple_names)
        */main_unit_frontend/native.o(.text.pp_emit_simple_names .text.unlikely.pp_emit_simple_names)
        */main_unit_frontend.c.o(.text.pp_scan_arguments .text.unlikely.pp_scan_arguments)
        */main_unit_frontend/native.o(.text.pp_scan_arguments .text.unlikely.pp_scan_arguments)
        */main_unit_frontend.c.o(.text.pp_plan_operators .text.unlikely.pp_plan_operators)
        */main_unit_frontend/native.o(.text.pp_plan_operators .text.unlikely.pp_plan_operators)
        */main_unit_frontend.c.o(.text.pp_finish_operators .text.unlikely.pp_finish_operators)
        */main_unit_frontend/native.o(.text.pp_finish_operators .text.unlikely.pp_finish_operators)
        */main_unit_frontend.c.o(.text.pp_emit_template .text.unlikely.pp_emit_template)
        */main_unit_frontend/native.o(.text.pp_emit_template .text.unlikely.pp_emit_template)
        */main_unit_frontend.c.o(.text.pp_template_find_names .text.unlikely.pp_template_find_names)
        */main_unit_frontend/native.o(.text.pp_template_find_names .text.unlikely.pp_template_find_names)
        */main_unit_frontend.c.o(.text.pp_template_operators .text.unlikely.pp_template_operators)
        */main_unit_frontend/native.o(.text.pp_template_operators .text.unlikely.pp_template_operators)
        */main_unit_frontend.c.o(.text.pp_template_make .text.unlikely.pp_template_make)
        */main_unit_frontend/native.o(.text.pp_template_make .text.unlikely.pp_template_make)
        */main_unit_frontend.c.o(.text.pp_invoke .text.unlikely.pp_invoke)
        */main_unit_frontend/native.o(.text.pp_invoke .text.unlikely.pp_invoke)
        */main_unit_frontend.c.o(.text.pp_read_token .text.unlikely.pp_read_token)
        */main_unit_frontend/native.o(.text.pp_read_token .text.unlikely.pp_read_token)
        */main_unit_frontend.c.o(.text.pp_collect_argument_slice .text.unlikely.pp_collect_argument_slice)
        */main_unit_frontend/native.o(.text.pp_collect_argument_slice .text.unlikely.pp_collect_argument_slice)
        */main_unit_frontend.c.o(.text.pp_history_copy .text.unlikely.pp_history_copy)
        */main_unit_frontend/native.o(.text.pp_history_copy .text.unlikely.pp_history_copy)
        */main_unit_frontend.c.o(.text.pp_lift_pragma_lines .text.unlikely.pp_lift_pragma_lines)
        */main_unit_frontend/native.o(.text.pp_lift_pragma_lines .text.unlikely.pp_lift_pragma_lines)
        */main_unit_frontend.c.o(.text.pp_finish_stream .text.unlikely.pp_finish_stream)
        */main_unit_frontend/native.o(.text.pp_finish_stream .text.unlikely.pp_finish_stream)
        */main_unit_frontend.c.o(.text.file_cache_directory .text.unlikely.file_cache_directory)
        */main_unit_frontend/native.o(.text.file_cache_directory .text.unlikely.file_cache_directory)
        */main_unit_frontend.c.o(.text.file_cache_probe .text.unlikely.file_cache_probe)
        */main_unit_frontend/native.o(.text.file_cache_probe .text.unlikely.file_cache_probe)
        */main_unit_frontend.c.o(.text.file_cache_add_path .text.unlikely.file_cache_add_path)
        */main_unit_frontend/native.o(.text.file_cache_add_path .text.unlikely.file_cache_add_path)
        */main_unit_frontend.c.o(.text.file_cache_identify .text.unlikely.file_cache_identify)
        */main_unit_frontend/native.o(.text.file_cache_identify .text.unlikely.file_cache_identify)
        */main_unit_frontend.c.o(.text.pp_build_directory .text.unlikely.pp_build_directory)
        */main_unit_frontend/native.o(.text.pp_build_directory .text.unlikely.pp_build_directory)
        */main_unit_frontend.c.o(.text.pp_markers_initialize .text.unlikely.pp_markers_initialize)
        */main_unit_frontend/native.o(.text.pp_markers_initialize .text.unlikely.pp_markers_initialize)
        */main_unit_frontend.c.o(.text.c_option_find .text.unlikely.c_option_find)
        */main_unit_frontend/native.o(.text.c_option_find .text.unlikely.c_option_find)
        */main_unit_frontend.c.o(.text.pp_take_family .text.unlikely.pp_take_family)
        */main_unit_frontend/native.o(.text.pp_take_family .text.unlikely.pp_take_family)
        */main_unit_frontend.c.o(.text.predefines_target .text.unlikely.predefines_target)
        */main_unit_frontend/native.o(.text.predefines_target .text.unlikely.predefines_target)
        */main_unit_frontend.c.o(.text.predefines_x86_architecture .text.unlikely.predefines_x86_architecture)
        */main_unit_frontend/native.o(.text.predefines_x86_architecture .text.unlikely.predefines_x86_architecture)
        */main_unit_frontend.c.o(.text.x86_target_parse .text.unlikely.x86_target_parse)
        */main_unit_frontend/native.o(.text.x86_target_parse .text.unlikely.x86_target_parse)
        */main_unit_frontend.c.o(.text.parse_brackets_avx512 .text.unlikely.parse_brackets_avx512)
        */main_unit_frontend/native.o(.text.parse_brackets_avx512 .text.unlikely.parse_brackets_avx512)
        */main_unit_frontend.c.o(.text.parse_typedefs .text.unlikely.parse_typedefs)
        */main_unit_frontend/native.o(.text.parse_typedefs .text.unlikely.parse_typedefs)
        */main_unit_frontend.c.o(.text.parse_classify_mask_avx512 .text.unlikely.parse_classify_mask_avx512)
        */main_unit_frontend/native.o(.text.parse_classify_mask_avx512 .text.unlikely.parse_classify_mask_avx512)
        */main_unit_frontend.c.o(.text.parse_secondary_avx512 .text.unlikely.parse_secondary_avx512)
        */main_unit_frontend/native.o(.text.parse_secondary_avx512 .text.unlikely.parse_secondary_avx512)
        */main_unit_frontend.c.o(.text.parse_fallback .text.unlikely.parse_fallback)
        */main_unit_frontend/native.o(.text.parse_fallback .text.unlikely.parse_fallback)
        */main_unit_frontend.c.o(.text.parse_roles_starting_avx512 .text.unlikely.parse_roles_starting_avx512)
        */main_unit_frontend/native.o(.text.parse_roles_starting_avx512 .text.unlikely.parse_roles_starting_avx512)
        */main_unit_frontend.c.o(.text.parse_roles_block_more_avx512 .text.unlikely.parse_roles_block_more_avx512)
        */main_unit_frontend/native.o(.text.parse_roles_block_more_avx512 .text.unlikely.parse_roles_block_more_avx512)
        */main_unit_frontend.c.o(.text.parse_top_parents8_avx512 .text.unlikely.parse_top_parents8_avx512)
        */main_unit_frontend/native.o(.text.parse_top_parents8_avx512 .text.unlikely.parse_top_parents8_avx512)
        */main_unit_frontend.c.o(.text.parse_top_prepare8_avx512 .text.unlikely.parse_top_prepare8_avx512)
        */main_unit_frontend/native.o(.text.parse_top_prepare8_avx512 .text.unlikely.parse_top_prepare8_avx512)
        */main_unit_frontend.c.o(.text.parse_statements_avx512 .text.unlikely.parse_statements_avx512)
        */main_unit_frontend/native.o(.text.parse_statements_avx512 .text.unlikely.parse_statements_avx512)
        */main_unit_frontend.c.o(.text.parse_check_avx512_period .text.unlikely.parse_check_avx512_period)
        */main_unit_frontend/native.o(.text.parse_check_avx512_period .text.unlikely.parse_check_avx512_period)
        */main_unit_frontend.c.o(.text.intern_initialize_in .text.unlikely.intern_initialize_in)
        */main_unit_frontend/native.o(.text.intern_initialize_in .text.unlikely.intern_initialize_in)
        */main_unit_frontend.c.o(.text.pp_diagnose_group .text.unlikely.pp_diagnose_group)
        */main_unit_frontend/native.o(.text.pp_diagnose_group .text.unlikely.pp_diagnose_group)
        */main_unit_frontend.c.o(.text.pp_diagnose_group_text .text.unlikely.pp_diagnose_group_text)
        */main_unit_frontend/native.o(.text.pp_diagnose_group_text .text.unlikely.pp_diagnose_group_text)
        */main_unit_frontend.c.o(.text.pp_stream_check .text.unlikely.pp_stream_check)
        */main_unit_frontend/native.o(.text.pp_stream_check .text.unlikely.pp_stream_check)
        */main_unit_checker.c.o(.text.arena_push .text.unlikely.arena_push)
        */main_unit_checker/native.o(.text.arena_push .text.unlikely.arena_push)
        */main_unit_checker.c.o(.text.arena_release .text.unlikely.arena_release)
        */main_unit_checker/native.o(.text.arena_release .text.unlikely.arena_release)
        */main_unit_checker.c.o(.text.run_source_check_command .text.unlikely.run_source_check_command)
        */main_unit_checker/native.o(.text.run_source_check_command .text.unlikely.run_source_check_command)
        */main_unit_checker.c.o(.text.intern_initialize .text.unlikely.intern_initialize)
        */main_unit_checker/native.o(.text.intern_initialize .text.unlikely.intern_initialize)
        */main_unit_checker.c.o(.text.c_option_find .text.unlikely.c_option_find)
        */main_unit_checker/native.o(.text.c_option_find .text.unlikely.c_option_find)
        */main_unit_checker.c.o(.text.predefines_host_of .text.unlikely.predefines_host_of)
        */main_unit_checker/native.o(.text.predefines_host_of .text.unlikely.predefines_host_of)
        */main_unit_checker.c.o(.text.predefines_apply .text.unlikely.predefines_apply)
        */main_unit_checker/native.o(.text.predefines_apply .text.unlikely.predefines_apply)
        */main_unit_checker.c.o(.text.intern_lay_out .text.unlikely.intern_lay_out)
        */main_unit_checker/native.o(.text.intern_lay_out .text.unlikely.intern_lay_out)
        */main_unit_checker.c.o(.text.intern_find_or_add .text.unlikely.intern_find_or_add)
        */main_unit_checker/native.o(.text.intern_find_or_add .text.unlikely.intern_find_or_add)
        */main_unit_checker.c.o(.text.type_initialize .text.unlikely.type_initialize)
        */main_unit_checker/native.o(.text.type_initialize .text.unlikely.type_initialize)
        */main_unit_checker.c.o(.text.arena_reserve_policy .text.unlikely.arena_reserve_policy)
        */main_unit_checker/native.o(.text.arena_reserve_policy .text.unlikely.arena_reserve_policy)
        */main_unit_checker.c.o(.text.c_bindings_initialize_zeroed .text.unlikely.c_bindings_initialize_zeroed)
        */main_unit_checker/native.o(.text.c_bindings_initialize_zeroed .text.unlikely.c_bindings_initialize_zeroed)
        */main_unit_checker.c.o(.text.parse_tree_columns .text.unlikely.parse_tree_columns)
        */main_unit_checker/native.o(.text.parse_tree_columns .text.unlikely.parse_tree_columns)
        */main_unit_checker.c.o(.text.pp_spelling .text.unlikely.pp_spelling)
        */main_unit_checker/native.o(.text.pp_spelling .text.unlikely.pp_spelling)
        */main_unit_checker.c.o(.text.pp_without_splices .text.unlikely.pp_without_splices)
        */main_unit_checker/native.o(.text.pp_without_splices .text.unlikely.pp_without_splices)
        */main_unit_checker.c.o(.text.builtin_intrinsic_filter_candidates .text.unlikely.builtin_intrinsic_filter_candidates)
        */main_unit_checker/native.o(.text.builtin_intrinsic_filter_candidates .text.unlikely.builtin_intrinsic_filter_candidates)
        */main_unit_checker.c.o(.text.pp_system_levels .text.unlikely.pp_system_levels)
        */main_unit_checker/native.o(.text.pp_system_levels .text.unlikely.pp_system_levels)
        */main_unit_checker.c.o(.text.c_bindings_restore .text.unlikely.c_bindings_restore)
        */main_unit_checker/native.o(.text.c_bindings_restore .text.unlikely.c_bindings_restore)
        */main_unit_checker.c.o(.text.c_bindings_declare .text.unlikely.c_bindings_declare)
        */main_unit_checker/native.o(.text.c_bindings_declare .text.unlikely.c_bindings_declare)
        */main_unit_checker.c.o(.text.type_pointer .text.unlikely.type_pointer)
        */main_unit_checker/native.o(.text.type_pointer .text.unlikely.type_pointer)
        */main_unit_checker.c.o(.text.type_find_or_add .text.unlikely.type_find_or_add)
        */main_unit_checker/native.o(.text.type_find_or_add .text.unlikely.type_find_or_add)
        */main_unit_checker.c.o(.text.type_index_find .text.unlikely.type_index_find)
        */main_unit_checker/native.o(.text.type_index_find .text.unlikely.type_index_find)
        */main_unit_checker.c.o(.text.type_function_full .text.unlikely.type_function_full)
        */main_unit_checker/native.o(.text.type_function_full .text.unlikely.type_function_full)
        */main_unit_checker.c.o(.text.type_canonical_compare .text.unlikely.type_canonical_compare)
        */main_unit_checker/native.o(.text.type_canonical_compare .text.unlikely.type_canonical_compare)
        */main_unit_checker.c.o(.text.type_grow_stack .text.unlikely.type_grow_stack)
        */main_unit_checker/native.o(.text.type_grow_stack .text.unlikely.type_grow_stack)
        */main_unit_checker.c.o(.text.type_compatible_at .text.unlikely.type_compatible_at)
        */main_unit_checker/native.o(.text.type_compatible_at .text.unlikely.type_compatible_at)
        */main_unit_checker.c.o(.text.type_merge_shallow .text.unlikely.type_merge_shallow)
        */main_unit_checker/native.o(.text.type_merge_shallow .text.unlikely.type_merge_shallow)
        */main_unit_checker.c.o(.text.type_conversion_operand .text.unlikely.type_conversion_operand)
        */main_unit_checker/native.o(.text.type_conversion_operand .text.unlikely.type_conversion_operand)
        */main_unit_checker.c.o(.text.type_usual_arithmetic .text.unlikely.type_usual_arithmetic)
        */main_unit_checker/native.o(.text.type_usual_arithmetic .text.unlikely.type_usual_arithmetic)
        */main_unit_checker.c.o(.text.type_integer_conversion .text.unlikely.type_integer_conversion)
        */main_unit_checker/native.o(.text.type_integer_conversion .text.unlikely.type_integer_conversion)
        */main_unit_checker.c.o(.text.type_composite_at .text.unlikely.type_composite_at)
        */main_unit_checker/native.o(.text.type_composite_at .text.unlikely.type_composite_at)
        */main_unit_checker.c.o(.text.cbuiltin_resolve .text.unlikely.cbuiltin_resolve)
        */main_unit_checker/native.o(.text.cbuiltin_resolve .text.unlikely.cbuiltin_resolve)
        */main_unit_checker.c.o(.text.cbuiltin_sized_entry .text.unlikely.cbuiltin_sized_entry)
        */main_unit_checker/native.o(.text.cbuiltin_sized_entry .text.unlikely.cbuiltin_sized_entry)
        */main_unit_checker.c.o(.text.type_tag .text.unlikely.type_tag)
        */main_unit_checker/native.o(.text.type_tag .text.unlikely.type_tag)
        */main_unit_checker.c.o(.text.type_record_define .text.unlikely.type_record_define)
        */main_unit_checker/native.o(.text.type_record_define .text.unlikely.type_record_define)
        */main_unit_checker.c.o(.text.type_record_layout .text.unlikely.type_record_layout)
        */main_unit_checker/native.o(.text.type_record_layout .text.unlikely.type_record_layout)
        */main_unit_checker.c.o(.text.type_check_member .text.unlikely.type_check_member)
        */main_unit_checker/native.o(.text.type_check_member .text.unlikely.type_check_member)
        */main_unit_checker.c.o(.text.pp_library_builtin .text.unlikely.pp_library_builtin)
        */main_unit_checker/native.o(.text.pp_library_builtin .text.unlikely.pp_library_builtin)
        */main_unit_checker.c.o(.text.lane_session_settle .text.unlikely.lane_session_settle)
        */main_unit_checker/native.o(.text.lane_session_settle .text.unlikely.lane_session_settle)
        */main_unit_checker.c.o(.text.c_bindings_sort .text.unlikely.c_bindings_sort)
        */main_unit_checker/native.o(.text.c_bindings_sort .text.unlikely.c_bindings_sort)
        */main_unit_checker.c.o(.text.c_lowering_prepare .text.unlikely.c_lowering_prepare)
        */main_unit_checker/native.o(.text.c_lowering_prepare .text.unlikely.c_lowering_prepare)
        */main_unit_checker.c.o(.text.c_lowering_vector .text.unlikely.c_lowering_vector)
        */main_unit_checker/native.o(.text.c_lowering_vector .text.unlikely.c_lowering_vector)
        */main_unit_checker.c.o(.text.lane_session_asked .text.unlikely.lane_session_asked)
        */main_unit_checker/native.o(.text.lane_session_asked .text.unlikely.lane_session_asked)
        */main_unit_checker.c.o(.text.link_initialize .text.unlikely.link_initialize)
        */main_unit_checker/native.o(.text.link_initialize .text.unlikely.link_initialize)
        */main_unit_checker.c.o(.text.emitted_from_tier0 .text.unlikely.emitted_from_tier0)
        */main_unit_checker/native.o(.text.emitted_from_tier0 .text.unlikely.emitted_from_tier0)
        */main_unit_checker.c.o(.text.branch_sizing_validate_branches .text.unlikely.branch_sizing_validate_branches)
        */main_unit_checker/native.o(.text.branch_sizing_validate_branches .text.unlikely.branch_sizing_validate_branches)
        */main_unit_checker.c.o(.text.unwind_write .text.unlikely.unwind_write)
        */main_unit_checker/native.o(.text.unwind_write .text.unlikely.unwind_write)
        */main_unit_checker.c.o(.text.link_add_fixup .text.unlikely.link_add_fixup)
        */main_unit_checker/native.o(.text.link_add_fixup .text.unlikely.link_add_fixup)
        */main_unit_checker.c.o(.text.abi_initialize_types .text.unlikely.abi_initialize_types)
        */main_unit_checker/native.o(.text.abi_initialize_types .text.unlikely.abi_initialize_types)
        */main_unit_checker.c.o(.text.x86_measure .text.unlikely.x86_measure)
        */main_unit_checker/native.o(.text.x86_measure .text.unlikely.x86_measure)
        */main_unit_checker.c.o(.text.branch_sizing_run .text.unlikely.branch_sizing_run)
        */main_unit_checker/native.o(.text.branch_sizing_run .text.unlikely.branch_sizing_run)
        */main_unit_checker.c.o(.text.link_check .text.unlikely.link_check)
        */main_unit_checker/native.o(.text.link_check .text.unlikely.link_check)
        */main_unit_checker.c.o(.text.link_groups_valid .text.unlikely.link_groups_valid)
        */main_unit_checker/native.o(.text.link_groups_valid .text.unlikely.link_groups_valid)
        */main_unit_checker.c.o(.text.link_check_fixups .text.unlikely.link_check_fixups)
        */main_unit_checker/native.o(.text.link_check_fixups .text.unlikely.link_check_fixups)
        */main_unit_checker.c.o(.text.abi_classify_levels .text.unlikely.abi_classify_levels)
        */main_unit_checker/native.o(.text.abi_classify_levels .text.unlikely.abi_classify_levels)
        */main_unit_checker.c.o(.text.abi_classify .text.unlikely.abi_classify)
        */main_unit_checker/native.o(.text.abi_classify .text.unlikely.abi_classify)
        */main_unit_checker.c.o(.text.abi_finish .text.unlikely.abi_finish)
        */main_unit_checker/native.o(.text.abi_finish .text.unlikely.abi_finish)
        */main_unit_checker.c.o(.text.abi_simple .text.unlikely.abi_simple)
        */main_unit_checker/native.o(.text.abi_simple .text.unlikely.abi_simple)
        */main_unit_checker.c.o(.text.abi_storage .text.unlikely.abi_storage)
        */main_unit_checker/native.o(.text.abi_storage .text.unlikely.abi_storage)
        */main_unit_checker.c.o(.text.abi_finish_passing .text.unlikely.abi_finish_passing)
        */main_unit_checker/native.o(.text.abi_finish_passing .text.unlikely.abi_finish_passing)
        */main_unit_checker.c.o(.text.abi_assign .text.unlikely.abi_assign)
        */main_unit_checker/native.o(.text.abi_assign .text.unlikely.abi_assign)
        */main_unit_checker.c.o(.text.tier0_validate_scalar_entries .text.unlikely.tier0_validate_scalar_entries)
        */main_unit_checker/native.o(.text.tier0_validate_scalar_entries .text.unlikely.tier0_validate_scalar_entries)
        */main_unit_checker.c.o(.text.tier0_frame_input_valid .text.unlikely.tier0_frame_input_valid)
        */main_unit_checker/native.o(.text.tier0_frame_input_valid .text.unlikely.tier0_frame_input_valid)
        */main_unit_checker.c.o(.text.tier0_parameters_valid .text.unlikely.tier0_parameters_valid)
        */main_unit_checker/native.o(.text.tier0_parameters_valid .text.unlikely.tier0_parameters_valid)
        */main_unit_checker.c.o(.text.tier0_validate_tables .text.unlikely.tier0_validate_tables)
        */main_unit_checker/native.o(.text.tier0_validate_tables .text.unlikely.tier0_validate_tables)
        */main_unit_checker.c.o(.text.x86_choose_forms .text.unlikely.x86_choose_forms)
        */main_unit_checker/native.o(.text.x86_choose_forms .text.unlikely.x86_choose_forms)
        */main_unit_checker.c.o(.text.tier0_compile_entries .text.unlikely.tier0_compile_entries)
        */main_unit_checker/native.o(.text.tier0_compile_entries .text.unlikely.tier0_compile_entries)
        */main_unit_checker.c.o(.text.tier0_push_entries .text.unlikely.tier0_push_entries)
        */main_unit_checker/native.o(.text.tier0_push_entries .text.unlikely.tier0_push_entries)
        */main_unit_checker.c.o(.text.tier0_generate .text.unlikely.tier0_generate)
        */main_unit_checker/native.o(.text.tier0_generate .text.unlikely.tier0_generate)
        */main_unit_checker.c.o(.text.tier0_frame_alignment_vector .text.unlikely.tier0_frame_alignment_vector)
        */main_unit_checker/native.o(.text.tier0_frame_alignment_vector .text.unlikely.tier0_frame_alignment_vector)
        */main_unit_checker.c.o(.text.tier0_emit_prologue .text.unlikely.tier0_emit_prologue)
        */main_unit_checker/native.o(.text.tier0_emit_prologue .text.unlikely.tier0_emit_prologue)
        */main_unit_checker.c.o(.text.tier0_emit_epilogue .text.unlikely.tier0_emit_epilogue)
        */main_unit_checker/native.o(.text.tier0_emit_epilogue .text.unlikely.tier0_emit_epilogue)
        */main_unit_checker.c.o(.text.tier0_preserved_vectors .text.unlikely.tier0_preserved_vectors)
        */main_unit_checker/native.o(.text.tier0_preserved_vectors .text.unlikely.tier0_preserved_vectors)
        */main_unit_checker.c.o(.text.tier0_emit_deferred .text.unlikely.tier0_emit_deferred)
        */main_unit_checker/native.o(.text.tier0_emit_deferred .text.unlikely.tier0_emit_deferred)
        */main_unit_checker.c.o(.text.tier0_emit_call_record .text.unlikely.tier0_emit_call_record)
        */main_unit_checker/native.o(.text.tier0_emit_call_record .text.unlikely.tier0_emit_call_record)
        */main_unit_checker.c.o(.text.tier0_emit_teardown .text.unlikely.tier0_emit_teardown)
        */main_unit_checker/native.o(.text.tier0_emit_teardown .text.unlikely.tier0_emit_teardown)
        */main_unit_checker.c.o(.text.emission_metadata_resolve .text.unlikely.emission_metadata_resolve)
        */main_unit_checker/native.o(.text.emission_metadata_resolve .text.unlikely.emission_metadata_resolve)
        */main_unit_checker.c.o(.text.link_add_name_hashed .text.unlikely.link_add_name_hashed)
        */main_unit_checker/native.o(.text.link_add_name_hashed .text.unlikely.link_add_name_hashed)
        */main_unit_checker.c.o(.text.unwind_tier0_frame_tails .text.unlikely.unwind_tier0_frame_tails)
        */main_unit_checker/native.o(.text.unwind_tier0_frame_tails .text.unlikely.unwind_tier0_frame_tails)
        */main_unit_checker.c.o(.text.unwind_function_rows .text.unlikely.unwind_function_rows)
        */main_unit_checker/native.o(.text.unwind_function_rows .text.unlikely.unwind_function_rows)
        */main_unit_checker.c.o(.text.x86_encode_16 .text.unlikely.x86_encode_16)
        */main_unit_checker/native.o(.text.x86_encode_16 .text.unlikely.x86_encode_16)
        */main_unit_checker.c.o(.text.unwind_rows_check .text.unlikely.unwind_rows_check)
        */main_unit_checker/native.o(.text.unwind_rows_check .text.unlikely.unwind_rows_check)
        */main_unit_checker.c.o(.text.unwind_batch .text.unlikely.unwind_batch)
        */main_unit_checker/native.o(.text.unwind_batch .text.unlikely.unwind_batch)
        */main_unit_checker.c.o(.text.arena_commit .text.unlikely.arena_commit)
        */main_unit_checker/native.o(.text.arena_commit .text.unlikely.arena_commit)
        */main_unit_checker.c.o(.text.object_write_file .text.unlikely.object_write_file)
        */main_unit_checker/native.o(.text.object_write_file .text.unlikely.object_write_file)
        */main_unit_checker.c.o(.text.object_prepare .text.unlikely.object_prepare)
        */main_unit_checker/native.o(.text.object_prepare .text.unlikely.object_prepare)
        */main_unit_checker.c.o(.text.object_build .text.unlikely.object_build)
        */main_unit_checker/native.o(.text.object_build .text.unlikely.object_build)
        */main_unit_checker.c.o(.text.check_driver_classify .text.unlikely.check_driver_classify)
        */main_unit_checker/native.o(.text.check_driver_classify .text.unlikely.check_driver_classify)
        */main_unit_checker.c.o(.text.dependency_check_destinations_counted .text.unlikely.dependency_check_destinations_counted)
        */main_unit_checker/native.o(.text.dependency_check_destinations_counted .text.unlikely.dependency_check_destinations_counted)
        */main_unit_checker.c.o(.text.lane_session_run .text.unlikely.lane_session_run)
        */main_unit_checker/native.o(.text.lane_session_run .text.unlikely.lane_session_run)
        */main_unit_checker.c.o(.text.check_data_publish .text.unlikely.check_data_publish)
        */main_unit_checker/native.o(.text.check_data_publish .text.unlikely.check_data_publish)
        */main_unit_checker.c.o(.text.run_check_command_mode .text.unlikely.run_check_command_mode)
        */main_unit_checker/native.o(.text.run_check_command_mode .text.unlikely.run_check_command_mode)
        */main_unit_checker.c.o(.text.check_data_prepare .text.unlikely.check_data_prepare)
        */main_unit_checker/native.o(.text.check_data_prepare .text.unlikely.check_data_prepare)
        */main_unit_checker.c.o(.text.check_program .text.unlikely.check_program)
        */main_unit_checker/native.o(.text.check_program .text.unlikely.check_program)
        */main_unit_checker.c.o(.text.check_program_select_mode .text.unlikely.check_program_select_mode)
        */main_unit_checker/native.o(.text.check_program_select_mode .text.unlikely.check_program_select_mode)
        */main_unit_checker.c.o(.text.check_program_target_features .text.unlikely.check_program_target_features)
        */main_unit_checker/native.o(.text.check_program_target_features .text.unlikely.check_program_target_features)
        */main_unit_checker.c.o(.text.check_request_scan_match .text.unlikely.check_request_scan_match)
        */main_unit_checker/native.o(.text.check_request_scan_match .text.unlikely.check_request_scan_match)
        */main_unit_checker.c.o(.text.check_request_refusal .text.unlikely.check_request_refusal)
        */main_unit_checker/native.o(.text.check_request_refusal .text.unlikely.check_request_refusal)
        */main_unit_checker.c.o(.text.check_request_codegen_option .text.unlikely.check_request_codegen_option)
        */main_unit_checker/native.o(.text.check_request_codegen_option .text.unlikely.check_request_codegen_option)
        */main_unit_checker.c.o(.text.check_input_target_supported .text.unlikely.check_input_target_supported)
        */main_unit_checker/native.o(.text.check_input_target_supported .text.unlikely.check_input_target_supported)
        */main_unit_checker.c.o(.text.check_graph_run .text.unlikely.check_graph_run)
        */main_unit_checker/native.o(.text.check_graph_run .text.unlikely.check_graph_run)
        */main_unit_checker.c.o(.text.check_input_packed_finalize .text.unlikely.check_input_packed_finalize)
        */main_unit_checker/native.o(.text.check_input_packed_finalize .text.unlikely.check_input_packed_finalize)
        */main_unit_checker.c.o(.text.check_input_warning_graph .text.unlikely.check_input_warning_graph)
        */main_unit_checker/native.o(.text.check_input_warning_graph .text.unlikely.check_input_warning_graph)
        */main_unit_checker.c.o(.text.check_initializers_run_events .text.unlikely.check_initializers_run_events)
        */main_unit_checker/native.o(.text.check_initializers_run_events .text.unlikely.check_initializers_run_events)
        */main_unit_checker.c.o(.text.check_diagnostic_first_pragma_error_mode .text.unlikely.check_diagnostic_first_pragma_error_mode)
        */main_unit_checker/native.o(.text.check_diagnostic_first_pragma_error_mode .text.unlikely.check_diagnostic_first_pragma_error_mode)
        */main_unit_checker.c.o(.text.check_initializers_warning_context .text.unlikely.check_initializers_warning_context)
        */main_unit_checker/native.o(.text.check_initializers_warning_context .text.unlikely.check_initializers_warning_context)
        */main_unit_checker.c.o(.text.check_initializers_warning_uses .text.unlikely.check_initializers_warning_uses)
        */main_unit_checker/native.o(.text.check_initializers_warning_uses .text.unlikely.check_initializers_warning_uses)
        */main_unit_checker.c.o(.text.check_warning_undefined_internal .text.unlikely.check_warning_undefined_internal)
        */main_unit_checker/native.o(.text.check_warning_undefined_internal .text.unlikely.check_warning_undefined_internal)
        */main_unit_checker.c.o(.text.check_input_run .text.unlikely.check_input_run)
        */main_unit_checker/native.o(.text.check_input_run .text.unlikely.check_input_run)
        */main_unit_checker.c.o(.text.check_input_count_tokens .text.unlikely.check_input_count_tokens)
        */main_unit_checker/native.o(.text.check_input_count_tokens .text.unlikely.check_input_count_tokens)
        */main_unit_checker.c.o(.text.check_sparse_reserve_wide .text.unlikely.check_sparse_reserve_wide)
        */main_unit_checker/native.o(.text.check_sparse_reserve_wide .text.unlikely.check_sparse_reserve_wide)
        */main_unit_checker.c.o(.text.check_graph_initialize .text.unlikely.check_graph_initialize)
        */main_unit_checker/native.o(.text.check_graph_initialize .text.unlikely.check_graph_initialize)
        */main_unit_checker.c.o(.text.check_input_expression_commas .text.unlikely.check_input_expression_commas)
        */main_unit_checker/native.o(.text.check_input_expression_commas .text.unlikely.check_input_expression_commas)
        */main_unit_checker.c.o(.text.check_input_intrinsic_initialize .text.unlikely.check_input_intrinsic_initialize)
        */main_unit_checker/native.o(.text.check_input_intrinsic_initialize .text.unlikely.check_input_intrinsic_initialize)
        */main_unit_checker.c.o(.text.check_input_resolve_range .text.unlikely.check_input_resolve_range)
        */main_unit_checker/native.o(.text.check_input_resolve_range .text.unlikely.check_input_resolve_range)
        */main_unit_checker.c.o(.text.check_input_controls .text.unlikely.check_input_controls)
        */main_unit_checker/native.o(.text.check_input_controls .text.unlikely.check_input_controls)
        */main_unit_checker.c.o(.text.check_input_diagnostic_recover .text.unlikely.check_input_diagnostic_recover)
        */main_unit_checker/native.o(.text.check_input_diagnostic_recover .text.unlikely.check_input_diagnostic_recover)
        */main_unit_checker.c.o(.text.check_input_builtin_capacity .text.unlikely.check_input_builtin_capacity)
        */main_unit_checker/native.o(.text.check_input_builtin_capacity .text.unlikely.check_input_builtin_capacity)
        */main_unit_checker.c.o(.text.check_input_packed_members .text.unlikely.check_input_packed_members)
        */main_unit_checker/native.o(.text.check_input_packed_members .text.unlikely.check_input_packed_members)
        */main_unit_checker.c.o(.text.check_warning_command_line .text.unlikely.check_warning_command_line)
        */main_unit_checker/native.o(.text.check_warning_command_line .text.unlikely.check_warning_command_line)
        */main_unit_checker.c.o(.text.check_literal_strings_by .text.unlikely.check_literal_strings_by)
        */main_unit_checker/native.o(.text.check_literal_strings_by .text.unlikely.check_literal_strings_by)
        */main_unit_checker.c.o(.text.check_literal_string_span .text.unlikely.check_literal_string_span)
        */main_unit_checker/native.o(.text.check_literal_string_span .text.unlikely.check_literal_string_span)
        */main_unit_checker.c.o(.text.check_literal_string_part .text.unlikely.check_literal_string_part)
        */main_unit_checker/native.o(.text.check_literal_string_part .text.unlikely.check_literal_string_part)
        */main_unit_checker.c.o(.text.check_literal_number .text.unlikely.check_literal_number)
        */main_unit_checker/native.o(.text.check_literal_number .text.unlikely.check_literal_number)
        */main_unit_checker.c.o(.text.check_literal_number_plain .text.unlikely.check_literal_number_plain)
        */main_unit_checker/native.o(.text.check_literal_number_plain .text.unlikely.check_literal_number_plain)
        */main_unit_checker.c.o(.text.check_input_system_token_map .text.unlikely.check_input_system_token_map)
        */main_unit_checker/native.o(.text.check_input_system_token_map .text.unlikely.check_input_system_token_map)
        */main_unit_checker.c.o(.text.check_input_bind .text.unlikely.check_input_bind)
        */main_unit_checker/native.o(.text.check_input_bind .text.unlikely.check_input_bind)
        */main_unit_checker.c.o(.text.check_input_declaration .text.unlikely.check_input_declaration)
        */main_unit_checker/native.o(.text.check_input_declaration .text.unlikely.check_input_declaration)
        */main_unit_checker.c.o(.text.check_input_tag_definition .text.unlikely.check_input_tag_definition)
        */main_unit_checker/native.o(.text.check_input_tag_definition .text.unlikely.check_input_tag_definition)
        */main_unit_checker.c.o(.text.check_sparse_set .text.unlikely.check_sparse_set)
        */main_unit_checker/native.o(.text.check_sparse_set .text.unlikely.check_sparse_set)
        */main_unit_checker.c.o(.text.check_input_vla_parameters .text.unlikely.check_input_vla_parameters)
        */main_unit_checker/native.o(.text.check_input_vla_parameters .text.unlikely.check_input_vla_parameters)
        */main_unit_checker.c.o(.text.check_input_noderef_set .text.unlikely.check_input_noderef_set)
        */main_unit_checker/native.o(.text.check_input_noderef_set .text.unlikely.check_input_noderef_set)
        */main_unit_checker.c.o(.text.check_input_specifiers .text.unlikely.check_input_specifiers)
        */main_unit_checker/native.o(.text.check_input_specifiers .text.unlikely.check_input_specifiers)
        */main_unit_checker.c.o(.text.check_input_declarator .text.unlikely.check_input_declarator)
        */main_unit_checker/native.o(.text.check_input_declarator .text.unlikely.check_input_declarator)
        */main_unit_checker.c.o(.text.check_input_string .text.unlikely.check_input_string)
        */main_unit_checker/native.o(.text.check_input_string .text.unlikely.check_input_string)
        */main_unit_checker.c.o(.text.check_input_rare_claim .text.unlikely.check_input_rare_claim)
        */main_unit_checker/native.o(.text.check_input_rare_claim .text.unlikely.check_input_rare_claim)
        */main_unit_checker.c.o(.text.check_input_noderef_make .text.unlikely.check_input_noderef_make)
        */main_unit_checker/native.o(.text.check_input_noderef_make .text.unlikely.check_input_noderef_make)
        */main_unit_checker.c.o(.text.check_action_integer_type .text.unlikely.check_action_integer_type)
        */main_unit_checker/native.o(.text.check_action_integer_type .text.unlikely.check_action_integer_type)
        */main_unit_checker.c.o(.text.check_action_scalar .text.unlikely.check_action_scalar)
        */main_unit_checker/native.o(.text.check_action_scalar .text.unlikely.check_action_scalar)
        */main_unit_checker.c.o(.text.check_action_truth .text.unlikely.check_action_truth)
        */main_unit_checker/native.o(.text.check_action_truth .text.unlikely.check_action_truth)
        */main_unit_checker.c.o(.text.check_action_convert_value .text.unlikely.check_action_convert_value)
        */main_unit_checker/native.o(.text.check_action_convert_value .text.unlikely.check_action_convert_value)
        */main_unit_checker.c.o(.text.check_action_convert_plain .text.unlikely.check_action_convert_plain)
        */main_unit_checker/native.o(.text.check_action_convert_plain .text.unlikely.check_action_convert_plain)
        */main_unit_checker.c.o(.text.check_action_fold_integer .text.unlikely.check_action_fold_integer)
        */main_unit_checker/native.o(.text.check_action_fold_integer .text.unlikely.check_action_fold_integer)
        */main_unit_checker.c.o(.text.check_action_operand_value .text.unlikely.check_action_operand_value)
        */main_unit_checker/native.o(.text.check_action_operand_value .text.unlikely.check_action_operand_value)
        */main_unit_checker.c.o(.text.check_action_source_complete .text.unlikely.check_action_source_complete)
        */main_unit_checker/native.o(.text.check_action_source_complete .text.unlikely.check_action_source_complete)
        */main_unit_checker.c.o(.text.check_overload_argument .text.unlikely.check_overload_argument)
        */main_unit_checker/native.o(.text.check_overload_argument .text.unlikely.check_overload_argument)
        */main_unit_checker.c.o(.text.check_action_arithmetic .text.unlikely.check_action_arithmetic)
        */main_unit_checker/native.o(.text.check_action_arithmetic .text.unlikely.check_action_arithmetic)
        */main_unit_checker.c.o(.text.check_action_query .text.unlikely.check_action_query)
        */main_unit_checker/native.o(.text.check_action_query .text.unlikely.check_action_query)
        */main_unit_checker.c.o(.text.check_action_call .text.unlikely.check_action_call)
        */main_unit_checker/native.o(.text.check_action_call .text.unlikely.check_action_call)
        */main_unit_checker.c.o(.text.check_const_append .text.unlikely.check_const_append)
        */main_unit_checker/native.o(.text.check_const_append .text.unlikely.check_const_append)
        */main_unit_checker.c.o(.text.check_input_constant_read .text.unlikely.check_input_constant_read)
        */main_unit_checker/native.o(.text.check_input_constant_read .text.unlikely.check_input_constant_read)
        */main_unit_checker.c.o(.text.check_constant_input_initialize .text.unlikely.check_constant_input_initialize)
        */main_unit_checker/native.o(.text.check_constant_input_initialize .text.unlikely.check_constant_input_initialize)
        */main_unit_checker.c.o(.text.check_constant_bind .text.unlikely.check_constant_bind)
        */main_unit_checker/native.o(.text.check_constant_bind .text.unlikely.check_constant_bind)
        */main_unit_checker.c.o(.text.check_constant_evaluate .text.unlikely.check_constant_evaluate)
        */main_unit_checker/native.o(.text.check_constant_evaluate .text.unlikely.check_constant_evaluate)
        */main_unit_checker.c.o(.text.check_constant_type .text.unlikely.check_constant_type)
        */main_unit_checker/native.o(.text.check_constant_type .text.unlikely.check_constant_type)
        */main_unit_checker.c.o(.text.check_constant_mark_type .text.unlikely.check_constant_mark_type)
        */main_unit_checker/native.o(.text.check_constant_mark_type .text.unlikely.check_constant_mark_type)
        */main_unit_checker.c.o(.text.check_constant_completed_tag .text.unlikely.check_constant_completed_tag)
        */main_unit_checker/native.o(.text.check_constant_completed_tag .text.unlikely.check_constant_completed_tag)
        */main_unit_checker.c.o(.text.check_input_tag_identity .text.unlikely.check_input_tag_identity)
        */main_unit_checker/native.o(.text.check_input_tag_identity .text.unlikely.check_input_tag_identity)
        */main_unit_checker.c.o(.text.check_input_read_qualifier .text.unlikely.check_input_read_qualifier)
        */main_unit_checker/native.o(.text.check_input_read_qualifier .text.unlikely.check_input_read_qualifier)
        */main_unit_checker.c.o(.text.check_input_attributes .text.unlikely.check_input_attributes)
        */main_unit_checker/native.o(.text.check_input_attributes .text.unlikely.check_input_attributes)
        */main_unit_checker.c.o(.text.check_input_predefined_type .text.unlikely.check_input_predefined_type)
        */main_unit_checker/native.o(.text.check_input_predefined_type .text.unlikely.check_input_predefined_type)
        */main_unit_checker.c.o(.text.check_input_attribute_read_item .text.unlikely.check_input_attribute_read_item)
        */main_unit_checker/native.o(.text.check_input_attribute_read_item .text.unlikely.check_input_attribute_read_item)
        */main_unit_checker.c.o(.text.check_input_attribute_validate .text.unlikely.check_input_attribute_validate)
        */main_unit_checker/native.o(.text.check_input_attribute_validate .text.unlikely.check_input_attribute_validate)
        */main_unit_checker.c.o(.text.check_input_attribute_append .text.unlikely.check_input_attribute_append)
        */main_unit_checker/native.o(.text.check_input_attribute_append .text.unlikely.check_input_attribute_append)
        */main_unit_checker.c.o(.text.check_input_attribute_gnu_rows .text.unlikely.check_input_attribute_gnu_rows)
        */main_unit_checker/native.o(.text.check_input_attribute_gnu_rows .text.unlikely.check_input_attribute_gnu_rows)
        */main_unit_checker.c.o(.text.check_input_attribute_subject_of .text.unlikely.check_input_attribute_subject_of)
        */main_unit_checker/native.o(.text.check_input_attribute_subject_of .text.unlikely.check_input_attribute_subject_of)
        */main_unit_checker.c.o(.text.check_input_attribute_count .text.unlikely.check_input_attribute_count)
        */main_unit_checker/native.o(.text.check_input_attribute_count .text.unlikely.check_input_attribute_count)
        */main_unit_checker.c.o(.text.check_input_subject_row .text.unlikely.check_input_subject_row)
        */main_unit_checker/native.o(.text.check_input_subject_row .text.unlikely.check_input_subject_row)
        */main_unit_checker.c.o(.text.check_input_attribute_string .text.unlikely.check_input_attribute_string)
        */main_unit_checker/native.o(.text.check_input_attribute_string .text.unlikely.check_input_attribute_string)
        */main_unit_checker.c.o(.text.check_input_mode_vector .text.unlikely.check_input_mode_vector)
        */main_unit_checker/native.o(.text.check_input_mode_vector .text.unlikely.check_input_mode_vector)
        */main_unit_checker.c.o(.text.check_input_attribute_ignored_lists .text.unlikely.check_input_attribute_ignored_lists)
        */main_unit_checker/native.o(.text.check_input_attribute_ignored_lists .text.unlikely.check_input_attribute_ignored_lists)
        */main_unit_checker.c.o(.text.check_input_tag_names .text.unlikely.check_input_tag_names)
        */main_unit_checker/native.o(.text.check_input_tag_names .text.unlikely.check_input_tag_names)
        */main_unit_checker.c.o(.text.check_input_attribute_subjects .text.unlikely.check_input_attribute_subjects)
        */main_unit_checker/native.o(.text.check_input_attribute_subjects .text.unlikely.check_input_attribute_subjects)
        */main_unit_checker.c.o(.text.check_input_attribute_merge .text.unlikely.check_input_attribute_merge)
        */main_unit_checker/native.o(.text.check_input_attribute_merge .text.unlikely.check_input_attribute_merge)
        */main_unit_checker.c.o(.text.check_sparse_wide_set .text.unlikely.check_sparse_wide_set)
        */main_unit_checker/native.o(.text.check_sparse_wide_set .text.unlikely.check_sparse_wide_set)
        */main_unit_checker.c.o(.text.check_input_generic_undeclared .text.unlikely.check_input_generic_undeclared)
        */main_unit_checker/native.o(.text.check_input_generic_undeclared .text.unlikely.check_input_generic_undeclared)
        */main_unit_checker.c.o(.text.check_input_names_drop .text.unlikely.check_input_names_drop)
        */main_unit_checker/native.o(.text.check_input_names_drop .text.unlikely.check_input_names_drop)
        */main_unit_checker.c.o(.text.check_input_attribute_kernel .text.unlikely.check_input_attribute_kernel)
        */main_unit_checker/native.o(.text.check_input_attribute_kernel .text.unlikely.check_input_attribute_kernel)
        */main_unit_checker.c.o(.text.check_input_attribute_begin .text.unlikely.check_input_attribute_begin)
        */main_unit_checker/native.o(.text.check_input_attribute_begin .text.unlikely.check_input_attribute_begin)
        */main_unit_checker.c.o(.text.check_input_attribute_excluding_in .text.unlikely.check_input_attribute_excluding_in)
        */main_unit_checker/native.o(.text.check_input_attribute_excluding_in .text.unlikely.check_input_attribute_excluding_in)
        */main_unit_checker.c.o(.text.check_input_gnu_escapes .text.unlikely.check_input_gnu_escapes)
        */main_unit_checker/native.o(.text.check_input_gnu_escapes .text.unlikely.check_input_gnu_escapes)
        */main_unit_checker.c.o(.text.check_input_tag_body .text.unlikely.check_input_tag_body)
        */main_unit_checker/native.o(.text.check_input_tag_body .text.unlikely.check_input_tag_body)
        */main_unit_checker.c.o(.text.check_constant_builtin_name .text.unlikely.check_constant_builtin_name)
        */main_unit_checker/native.o(.text.check_constant_builtin_name .text.unlikely.check_constant_builtin_name)
        */main_unit_checker.c.o(.text.check_input_intrinsic_prepare .text.unlikely.check_input_intrinsic_prepare)
        */main_unit_checker/native.o(.text.check_input_intrinsic_prepare .text.unlikely.check_input_intrinsic_prepare)
        */main_unit_checker.c.o(.text.check_action_i64 .text.unlikely.check_action_i64)
        */main_unit_checker/native.o(.text.check_action_i64 .text.unlikely.check_action_i64)
        */main_unit_checker.c.o(.text.check_input_attribute_argument_value .text.unlikely.check_input_attribute_argument_value)
        */main_unit_checker/native.o(.text.check_input_attribute_argument_value .text.unlikely.check_input_attribute_argument_value)
        */main_unit_checker.c.o(.text.check_input_constant_fold_warning .text.unlikely.check_input_constant_fold_warning)
        */main_unit_checker/native.o(.text.check_input_constant_fold_warning .text.unlikely.check_input_constant_fold_warning)
        */main_unit_checker.c.o(.text.check_input_warning_range .text.unlikely.check_input_warning_range)
        */main_unit_checker/native.o(.text.check_input_warning_range .text.unlikely.check_input_warning_range)
        */main_unit_checker.c.o(.text.check_input_warning_add_value .text.unlikely.check_input_warning_add_value)
        */main_unit_checker/native.o(.text.check_input_warning_add_value .text.unlikely.check_input_warning_add_value)
        */main_unit_checker.c.o(.text.check_constant_action .text.unlikely.check_constant_action)
        */main_unit_checker/native.o(.text.check_constant_action .text.unlikely.check_constant_action)
        */main_unit_checker.c.o(.text.check_warning_ordered_event .text.unlikely.check_warning_ordered_event)
        */main_unit_checker/native.o(.text.check_warning_ordered_event .text.unlikely.check_warning_ordered_event)
        */main_unit_checker.c.o(.text.check_input_library_names .text.unlikely.check_input_library_names)
        */main_unit_checker/native.o(.text.check_input_library_names .text.unlikely.check_input_library_names)
        */main_unit_checker.c.o(.text.check_constant_enum_mix .text.unlikely.check_constant_enum_mix)
        */main_unit_checker/native.o(.text.check_constant_enum_mix .text.unlikely.check_constant_enum_mix)
        */main_unit_checker.c.o(.text.check_constant_specifiers .text.unlikely.check_constant_specifiers)
        */main_unit_checker/native.o(.text.check_constant_specifiers .text.unlikely.check_constant_specifiers)
        */main_unit_checker.c.o(.text.check_input_attribute_abi_origin .text.unlikely.check_input_attribute_abi_origin)
        */main_unit_checker/native.o(.text.check_input_attribute_abi_origin .text.unlikely.check_input_attribute_abi_origin)
        */main_unit_checker.c.o(.text.check_input_noderef_adjust_parameter .text.unlikely.check_input_noderef_adjust_parameter)
        */main_unit_checker/native.o(.text.check_input_noderef_adjust_parameter .text.unlikely.check_input_noderef_adjust_parameter)
        */main_unit_checker.c.o(.text.check_input_attribute_type .text.unlikely.check_input_attribute_type)
        */main_unit_checker/native.o(.text.check_input_attribute_type .text.unlikely.check_input_attribute_type)
        */main_unit_checker.c.o(.text.check_input_attribute_conventions .text.unlikely.check_input_attribute_conventions)
        */main_unit_checker/native.o(.text.check_input_attribute_conventions .text.unlikely.check_input_attribute_conventions)
        */main_unit_checker.c.o(.text.check_const_storage .text.unlikely.check_const_storage)
        */main_unit_checker/native.o(.text.check_const_storage .text.unlikely.check_const_storage)
        */main_unit_checker.c.o(.text.check_input_bind_checked .text.unlikely.check_input_bind_checked)
        */main_unit_checker/native.o(.text.check_input_bind_checked .text.unlikely.check_input_bind_checked)
        */main_unit_checker.c.o(.text.check_input_builtin_declaration .text.unlikely.check_input_builtin_declaration)
        */main_unit_checker/native.o(.text.check_input_builtin_declaration .text.unlikely.check_input_builtin_declaration)
        */main_unit_checker.c.o(.text.check_input_contract_inherit .text.unlikely.check_input_contract_inherit)
        */main_unit_checker/native.o(.text.check_input_contract_inherit .text.unlikely.check_input_contract_inherit)
        */main_unit_checker.c.o(.text.check_input_naked_inherit .text.unlikely.check_input_naked_inherit)
        */main_unit_checker/native.o(.text.check_input_naked_inherit .text.unlikely.check_input_naked_inherit)
        */main_unit_checker.c.o(.text.check_input_attribute_late .text.unlikely.check_input_attribute_late)
        */main_unit_checker/native.o(.text.check_input_attribute_late .text.unlikely.check_input_attribute_late)
        */main_unit_checker.c.o(.text.check_input_attribute_excludable .text.unlikely.check_input_attribute_excludable)
        */main_unit_checker/native.o(.text.check_input_attribute_excludable .text.unlikely.check_input_attribute_excludable)
        */main_unit_checker.c.o(.text.check_input_constant .text.unlikely.check_input_constant)
        */main_unit_checker/native.o(.text.check_input_constant .text.unlikely.check_input_constant)
        */main_unit_checker.c.o(.text.check_input_empty_declaration_tag .text.unlikely.check_input_empty_declaration_tag)
        */main_unit_checker/native.o(.text.check_input_empty_declaration_tag .text.unlikely.check_input_empty_declaration_tag)
        */main_unit_checker.c.o(.text.check_input_attribute_function .text.unlikely.check_input_attribute_function)
        */main_unit_checker/native.o(.text.check_input_attribute_function .text.unlikely.check_input_attribute_function)
        */main_unit_checker.c.o(.text.check_input_alignas_underaligned .text.unlikely.check_input_alignas_underaligned)
        */main_unit_checker/native.o(.text.check_input_alignas_underaligned .text.unlikely.check_input_alignas_underaligned)
        */main_unit_checker.c.o(.text.check_input_transparent_union .text.unlikely.check_input_transparent_union)
        */main_unit_checker/native.o(.text.check_input_transparent_union .text.unlikely.check_input_transparent_union)
        */main_unit_checker.c.o(.text.check_input_thread_names .text.unlikely.check_input_thread_names)
        */main_unit_checker/native.o(.text.check_input_thread_names .text.unlikely.check_input_thread_names)
        */main_unit_checker.c.o(.text.check_input_attribute_expression .text.unlikely.check_input_attribute_expression)
        */main_unit_checker/native.o(.text.check_input_attribute_expression .text.unlikely.check_input_attribute_expression)
        */main_unit_checker.c.o(.text.check_input_attribute_unused .text.unlikely.check_input_attribute_unused)
        */main_unit_checker/native.o(.text.check_input_attribute_unused .text.unlikely.check_input_attribute_unused)
        */main_unit_checker.c.o(.text.check_input_tag .text.unlikely.check_input_tag)
        */main_unit_checker/native.o(.text.check_input_tag .text.unlikely.check_input_tag)
        */main_unit_checker.c.o(.text.check_input_read_attributes .text.unlikely.check_input_read_attributes)
        */main_unit_checker/native.o(.text.check_input_read_attributes .text.unlikely.check_input_read_attributes)
        */main_unit_checker.c.o(.text.check_input_tag_frame .text.unlikely.check_input_tag_frame)
        */main_unit_checker/native.o(.text.check_input_tag_frame .text.unlikely.check_input_tag_frame)
        */main_unit_checker.c.o(.text.check_input_declarator_step .text.unlikely.check_input_declarator_step)
        */main_unit_checker/native.o(.text.check_input_declarator_step .text.unlikely.check_input_declarator_step)
        */main_unit_checker.c.o(.text.check_input_constant_ice .text.unlikely.check_input_constant_ice)
        */main_unit_checker/native.o(.text.check_input_constant_ice .text.unlikely.check_input_constant_ice)
        */main_unit_checker.c.o(.text.check_input_attribute_nonnull_parameter .text.unlikely.check_input_attribute_nonnull_parameter)
        */main_unit_checker/native.o(.text.check_input_attribute_nonnull_parameter .text.unlikely.check_input_attribute_nonnull_parameter)
        */main_unit_checker.c.o(.text.check_input_attribute_function_typed .text.unlikely.check_input_attribute_function_typed)
        */main_unit_checker/native.o(.text.check_input_attribute_function_typed .text.unlikely.check_input_attribute_function_typed)
        */main_unit_checker.c.o(.text.check_input_capture_names .text.unlikely.check_input_capture_names)
        */main_unit_checker/native.o(.text.check_input_capture_names .text.unlikely.check_input_capture_names)
        */main_unit_checker.c.o(.text.check_input_local_label_pop .text.unlikely.check_input_local_label_pop)
        */main_unit_checker/native.o(.text.check_input_local_label_pop .text.unlikely.check_input_local_label_pop)
        */main_unit_checker.c.o(.text.check_input_unused_labels .text.unlikely.check_input_unused_labels)
        */main_unit_checker/native.o(.text.check_input_unused_labels .text.unlikely.check_input_unused_labels)
        */main_unit_checker.c.o(.text.check_input_binding_events .text.unlikely.check_input_binding_events)
        */main_unit_checker/native.o(.text.check_input_binding_events .text.unlikely.check_input_binding_events)
        */main_unit_checker.c.o(.text.check_input_binding_answers .text.unlikely.check_input_binding_answers)
        */main_unit_checker/native.o(.text.check_input_binding_answers .text.unlikely.check_input_binding_answers)
        */main_unit_checker.c.o(.text.check_input_binding_answer .text.unlikely.check_input_binding_answer)
        */main_unit_checker/native.o(.text.check_input_binding_answer .text.unlikely.check_input_binding_answer)
        */main_unit_checker.c.o(.text.check_input_constant_contexts_range .text.unlikely.check_input_constant_contexts_range)
        */main_unit_checker/native.o(.text.check_input_constant_contexts_range .text.unlikely.check_input_constant_contexts_range)
        */main_unit_checker.c.o(.text.check_input_expression_classes .text.unlikely.check_input_expression_classes)
        */main_unit_checker/native.o(.text.check_input_expression_classes .text.unlikely.check_input_expression_classes)
        */main_unit_checker.c.o(.text.check_graph_record_nodes .text.unlikely.check_graph_record_nodes)
        */main_unit_checker/native.o(.text.check_graph_record_nodes .text.unlikely.check_graph_record_nodes)
        */main_unit_checker.c.o(.text.check_input_expressions_coded_range .text.unlikely.check_input_expressions_coded_range)
        */main_unit_checker/native.o(.text.check_input_expressions_coded_range .text.unlikely.check_input_expressions_coded_range)
        */main_unit_checker.c.o(.text.check_graph_classes .text.unlikely.check_graph_classes)
        */main_unit_checker/native.o(.text.check_graph_classes .text.unlikely.check_graph_classes)
        */main_unit_checker.c.o(.text.check_input_expression_identifiers .text.unlikely.check_input_expression_identifiers)
        */main_unit_checker/native.o(.text.check_input_expression_identifiers .text.unlikely.check_input_expression_identifiers)
        */main_unit_checker.c.o(.text.check_input_expression_literals .text.unlikely.check_input_expression_literals)
        */main_unit_checker/native.o(.text.check_input_expression_literals .text.unlikely.check_input_expression_literals)
        */main_unit_checker.c.o(.text.check_input_expression_flush .text.unlikely.check_input_expression_flush)
        */main_unit_checker/native.o(.text.check_input_expression_flush .text.unlikely.check_input_expression_flush)
        */main_unit_checker.c.o(.text.check_input_expression_call .text.unlikely.check_input_expression_call)
        */main_unit_checker/native.o(.text.check_input_expression_call .text.unlikely.check_input_expression_call)
        */main_unit_checker.c.o(.text.check_input_expression_string .text.unlikely.check_input_expression_string)
        */main_unit_checker/native.o(.text.check_input_expression_string .text.unlikely.check_input_expression_string)
        */main_unit_checker.c.o(.text.check_input_expression_return .text.unlikely.check_input_expression_return)
        */main_unit_checker/native.o(.text.check_input_expression_return .text.unlikely.check_input_expression_return)
        */main_unit_checker.c.o(.text.check_input_asm_labels .text.unlikely.check_input_asm_labels)
        */main_unit_checker/native.o(.text.check_input_asm_labels .text.unlikely.check_input_asm_labels)
        */main_unit_checker.c.o(.text.check_input_asm_labelled_tokens .text.unlikely.check_input_asm_labelled_tokens)
        */main_unit_checker/native.o(.text.check_input_asm_labelled_tokens .text.unlikely.check_input_asm_labelled_tokens)
        */main_unit_checker.c.o(.text.check_sparse_wide_entries .text.unlikely.check_sparse_wide_entries)
        */main_unit_checker/native.o(.text.check_sparse_wide_entries .text.unlikely.check_sparse_wide_entries)
        */main_unit_checker.c.o(.text.check_graph_query_runtime .text.unlikely.check_graph_query_runtime)
        */main_unit_checker/native.o(.text.check_graph_query_runtime .text.unlikely.check_graph_query_runtime)
        */main_unit_checker.c.o(.text.check_graph_report_node .text.unlikely.check_graph_report_node)
        */main_unit_checker/native.o(.text.check_graph_report_node .text.unlikely.check_graph_report_node)
        */main_unit_checker.c.o(.text.check_init_declarations .text.unlikely.check_init_declarations)
        */main_unit_checker/native.o(.text.check_init_declarations .text.unlikely.check_init_declarations)
        */main_unit_checker.c.o(.text.check_program_case_conflicts .text.unlikely.check_program_case_conflicts)
        */main_unit_checker/native.o(.text.check_program_case_conflicts .text.unlikely.check_program_case_conflicts)
        */main_unit_checker.c.o(.text.check_diagnostic_first_error .text.unlikely.check_diagnostic_first_error)
        */main_unit_checker/native.o(.text.check_diagnostic_first_error .text.unlikely.check_diagnostic_first_error)
        */main_unit_checker.c.o(.text.check_program_openings .text.unlikely.check_program_openings)
        */main_unit_checker/native.o(.text.check_program_openings .text.unlikely.check_program_openings)
        */main_unit_checker.c.o(.text.check_program_plans .text.unlikely.check_program_plans)
        */main_unit_checker/native.o(.text.check_program_plans .text.unlikely.check_program_plans)
        */main_unit_checker.c.o(.text.check_program_return_facts .text.unlikely.check_program_return_facts)
        */main_unit_checker/native.o(.text.check_program_return_facts .text.unlikely.check_program_return_facts)
        */main_unit_checker.c.o(.text.check_program_return_flow .text.unlikely.check_program_return_flow)
        */main_unit_checker/native.o(.text.check_program_return_flow .text.unlikely.check_program_return_flow)
        */main_unit_checker.c.o(.text.check_program_alias_number .text.unlikely.check_program_alias_number)
        */main_unit_checker/native.o(.text.check_program_alias_number .text.unlikely.check_program_alias_number)
        */main_unit_checker.c.o(.text.check_program_attribute_keys .text.unlikely.check_program_attribute_keys)
        */main_unit_checker/native.o(.text.check_program_attribute_keys .text.unlikely.check_program_attribute_keys)
        */main_unit_checker.c.o(.text.check_program_patchable_keys .text.unlikely.check_program_patchable_keys)
        */main_unit_checker/native.o(.text.check_program_patchable_keys .text.unlikely.check_program_patchable_keys)
        */main_unit_checker.c.o(.text.check_program_x86_diagnostics .text.unlikely.check_program_x86_diagnostics)
        */main_unit_checker/native.o(.text.check_program_x86_diagnostics .text.unlikely.check_program_x86_diagnostics)
        */main_unit_checker.c.o(.text.check_program_case .text.unlikely.check_program_case)
        */main_unit_checker/native.o(.text.check_program_case .text.unlikely.check_program_case)
        */main_unit_checker.c.o(.text.check_program_return_library_names .text.unlikely.check_program_return_library_names)
        */main_unit_checker/native.o(.text.check_program_return_library_names .text.unlikely.check_program_return_library_names)
        */main_unit_checker.c.o(.text.check_control_drain .text.unlikely.check_control_drain)
        */main_unit_checker/native.o(.text.check_control_drain .text.unlikely.check_control_drain)
        */main_unit_checker.c.o(.text.check_control_children .text.unlikely.check_control_children)
        */main_unit_checker/native.o(.text.check_control_children .text.unlikely.check_control_children)
        */main_unit_checker.c.o(.text.check_program_reference_roots .text.unlikely.check_program_reference_roots)
        */main_unit_checker/native.o(.text.check_program_reference_roots .text.unlikely.check_program_reference_roots)
        */main_unit_checker.c.o(.text.check_program_call_extreme .text.unlikely.check_program_call_extreme)
        */main_unit_checker/native.o(.text.check_program_call_extreme .text.unlikely.check_program_call_extreme)
        */main_unit_checker.c.o(.text.check_program_static_object .text.unlikely.check_program_static_object)
        */main_unit_checker/native.o(.text.check_program_static_object .text.unlikely.check_program_static_object)
        */main_unit_checker.c.o(.text.check_program_event_push .text.unlikely.check_program_event_push)
        */main_unit_checker/native.o(.text.check_program_event_push .text.unlikely.check_program_event_push)
        */main_unit_checker.c.o(.text.check_program_body_eager .text.unlikely.check_program_body_eager)
        */main_unit_checker/native.o(.text.check_program_body_eager .text.unlikely.check_program_body_eager)
        */main_unit_checker.c.o(.text.check_target_feature_map .text.unlikely.check_target_feature_map)
        */main_unit_checker/native.o(.text.check_target_feature_map .text.unlikely.check_target_feature_map)
        */main_unit_checker.c.o(.text.check_program_emit_timed .text.unlikely.check_program_emit_timed)
        */main_unit_checker/native.o(.text.check_program_emit_timed .text.unlikely.check_program_emit_timed)
        */main_unit_checker.c.o(.text.check_clock_mark .text.unlikely.check_clock_mark)
        */main_unit_checker/native.o(.text.check_clock_mark .text.unlikely.check_clock_mark)
        */main_unit_checker.c.o(.text.check_lower_prepare .text.unlikely.check_lower_prepare)
        */main_unit_checker/native.o(.text.check_lower_prepare .text.unlikely.check_lower_prepare)
        */main_unit_checker.c.o(.text.check_program_object_access .text.unlikely.check_program_object_access)
        */main_unit_checker/native.o(.text.check_program_object_access .text.unlikely.check_program_object_access)
        */main_unit_checker.c.o(.text.check_tier1_inline_table .text.unlikely.check_tier1_inline_table)
        */main_unit_checker/native.o(.text.check_tier1_inline_table .text.unlikely.check_tier1_inline_table)
        */main_unit_checker.c.o(.text.check_lower_finish .text.unlikely.check_lower_finish)
        */main_unit_checker/native.o(.text.check_lower_finish .text.unlikely.check_lower_finish)
        */main_unit_checker.c.o(.text.check_program_body_symbol .text.unlikely.check_program_body_symbol)
        */main_unit_checker/native.o(.text.check_program_body_symbol .text.unlikely.check_program_body_symbol)
        */main_unit_checker.c.o(.text.check_program_emit_frame_checked .text.unlikely.check_program_emit_frame_checked)
        */main_unit_checker/native.o(.text.check_program_emit_frame_checked .text.unlikely.check_program_emit_frame_checked)
        */main_unit_checker.c.o(.text.check_lower_node_counts .text.unlikely.check_lower_node_counts)
        */main_unit_checker/native.o(.text.check_lower_node_counts .text.unlikely.check_lower_node_counts)
        */main_unit_checker.c.o(.text.check_lower_limb_room .text.unlikely.check_lower_limb_room)
        */main_unit_checker/native.o(.text.check_lower_limb_room .text.unlikely.check_lower_limb_room)
        */main_unit_checker.c.o(.text.check_program_helpers .text.unlikely.check_program_helpers)
        */main_unit_checker/native.o(.text.check_program_helpers .text.unlikely.check_program_helpers)
        */main_unit_checker.c.o(.text.check_program_asm_plan .text.unlikely.check_program_asm_plan)
        */main_unit_checker/native.o(.text.check_program_asm_plan .text.unlikely.check_program_asm_plan)
        */main_unit_checker.c.o(.text.check_lower_copy_type_facts .text.unlikely.check_lower_copy_type_facts)
        */main_unit_checker/native.o(.text.check_lower_copy_type_facts .text.unlikely.check_lower_copy_type_facts)
        */main_unit_checker.c.o(.text.check_lower_twice_names .text.unlikely.check_lower_twice_names)
        */main_unit_checker/native.o(.text.check_lower_twice_names .text.unlikely.check_lower_twice_names)
        */main_unit_checker.c.o(.text.check_lower_writer_begin .text.unlikely.check_lower_writer_begin)
        */main_unit_checker/native.o(.text.check_lower_writer_begin .text.unlikely.check_lower_writer_begin)
        */main_unit_checker.c.o(.text.worker_budget_initialize .text.unlikely.worker_budget_initialize)
        */main_unit_checker/native.o(.text.worker_budget_initialize .text.unlikely.worker_budget_initialize)
        */main_unit_checker.c.o(.text.worker_budget_release .text.unlikely.worker_budget_release)
        */main_unit_checker/native.o(.text.worker_budget_release .text.unlikely.worker_budget_release)
        */main_unit_checker.c.o(.text.check_program_emit_part .text.unlikely.check_program_emit_part)
        */main_unit_checker/native.o(.text.check_program_emit_part .text.unlikely.check_program_emit_part)
        */main_unit_checker.c.o(.text.check_lower_part .text.unlikely.check_lower_part)
        */main_unit_checker/native.o(.text.check_lower_part .text.unlikely.check_lower_part)
        */main_unit_checker.c.o(.text.check_lower_convention .text.unlikely.check_lower_convention)
        */main_unit_checker/native.o(.text.check_lower_convention .text.unlikely.check_lower_convention)
        */main_unit_checker.c.o(.text.check_lower_vector_of .text.unlikely.check_lower_vector_of)
        */main_unit_checker/native.o(.text.check_lower_vector_of .text.unlikely.check_lower_vector_of)
        */main_unit_checker.c.o(.text.check_lower_emit .text.unlikely.check_lower_emit)
        */main_unit_checker/native.o(.text.check_lower_emit .text.unlikely.check_lower_emit)
        */main_unit_checker.c.o(.text.check_lower_control .text.unlikely.check_lower_control)
        */main_unit_checker/native.o(.text.check_lower_control .text.unlikely.check_lower_control)
        */main_unit_checker.c.o(.text.check_lower_drain .text.unlikely.check_lower_drain)
        */main_unit_checker/native.o(.text.check_lower_drain .text.unlikely.check_lower_drain)
        */main_unit_checker.c.o(.text.check_lower_preserve .text.unlikely.check_lower_preserve)
        */main_unit_checker/native.o(.text.check_lower_preserve .text.unlikely.check_lower_preserve)
        */main_unit_checker.c.o(.text.check_lower_instruction .text.unlikely.check_lower_instruction)
        */main_unit_checker/native.o(.text.check_lower_instruction .text.unlikely.check_lower_instruction)
        */main_unit_checker.c.o(.text.check_lower_convert .text.unlikely.check_lower_convert)
        */main_unit_checker/native.o(.text.check_lower_convert .text.unlikely.check_lower_convert)
        */main_unit_checker.c.o(.text.check_lower_expression .text.unlikely.check_lower_expression)
        */main_unit_checker/native.o(.text.check_lower_expression .text.unlikely.check_lower_expression)
        */main_unit_checker.c.o(.text.check_lower_call_result .text.unlikely.check_lower_call_result)
        */main_unit_checker/native.o(.text.check_lower_call_result .text.unlikely.check_lower_call_result)
        */main_unit_checker.c.o(.text.check_lower_operand .text.unlikely.check_lower_operand)
        */main_unit_checker/native.o(.text.check_lower_operand .text.unlikely.check_lower_operand)
        */main_unit_checker.c.o(.text.check_lower_address .text.unlikely.check_lower_address)
        */main_unit_checker/native.o(.text.check_lower_address .text.unlikely.check_lower_address)
        */main_unit_checker.c.o(.text.check_lower_call .text.unlikely.check_lower_call)
        */main_unit_checker/native.o(.text.check_lower_call .text.unlikely.check_lower_call)
        */main_unit_checker.c.o(.text.check_lower_constant .text.unlikely.check_lower_constant)
        */main_unit_checker/native.o(.text.check_lower_constant .text.unlikely.check_lower_constant)
        */main_unit_checker.c.o(.text.check_data_emit .text.unlikely.check_data_emit)
        */main_unit_checker/native.o(.text.check_data_emit .text.unlikely.check_data_emit)
        */main_unit_checker.c.o(.text.check_data_string_pool .text.unlikely.check_data_string_pool)
        */main_unit_checker/native.o(.text.check_data_string_pool .text.unlikely.check_data_string_pool)
        */main_unit_checker.c.o(.text.check_data_plan_object .text.unlikely.check_data_plan_object)
        */main_unit_checker/native.o(.text.check_data_plan_object .text.unlikely.check_data_plan_object)
        */main_unit_checker.c.o(.text.check_data_string_candidate .text.unlikely.check_data_string_candidate)
        */main_unit_checker/native.o(.text.check_data_string_candidate .text.unlikely.check_data_string_candidate)
        */main_unit_checker.c.o(.text.check_data_plan_header .text.unlikely.check_data_plan_header)
        */main_unit_checker/native.o(.text.check_data_plan_header .text.unlikely.check_data_plan_header)
        */main_unit_checker.c.o(.text.check_data_payload .text.unlikely.check_data_payload)
        */main_unit_checker/native.o(.text.check_data_payload .text.unlikely.check_data_payload)
        */main_unit_checker.c.o(.text.check_driver_flow .text.unlikely.check_driver_flow)
        */main_unit_checker/native.o(.text.check_driver_flow .text.unlikely.check_driver_flow)
        */main_unit_checker.c.o(.text.check_driver_command .text.unlikely.check_driver_command)
        */main_unit_checker/native.o(.text.check_driver_command .text.unlikely.check_driver_command)
        */main_unit_checker.c.o(.text.check_driver_unit .text.unlikely.check_driver_unit)
        */main_unit_checker/native.o(.text.check_driver_unit .text.unlikely.check_driver_unit)
        */main_unit_checker.c.o(.text.check_driver_warning_promoted .text.unlikely.check_driver_warning_promoted)
        */main_unit_checker/native.o(.text.check_driver_warning_promoted .text.unlikely.check_driver_warning_promoted)
        */main_unit_checker.c.o(.text.check_driver_rejected_warnings .text.unlikely.check_driver_rejected_warnings)
        */main_unit_checker/native.o(.text.check_driver_rejected_warnings .text.unlikely.check_driver_rejected_warnings)
        */main_unit_checker.c.o(.text.check_driver_unit_end_split .text.unlikely.check_driver_unit_end_split)
        */main_unit_checker/native.o(.text.check_driver_unit_end_split .text.unlikely.check_driver_unit_end_split)
        */main_unit_checker.c.o(.text.check_driver_initializer_warning_events .text.unlikely.check_driver_initializer_warning_events)
        */main_unit_checker/native.o(.text.check_driver_initializer_warning_events .text.unlikely.check_driver_initializer_warning_events)
        */main_unit_checker.c.o(.text.check_driver_warning_events_at .text.unlikely.check_driver_warning_events_at)
        */main_unit_checker/native.o(.text.check_driver_warning_events_at .text.unlikely.check_driver_warning_events_at)
        */main_unit_checker.c.o(.text.check_driver_default_error_warnings .text.unlikely.check_driver_default_error_warnings)
        */main_unit_checker/native.o(.text.check_driver_default_error_warnings .text.unlikely.check_driver_default_error_warnings)
        */main_unit_checker.c.o(.text.check_driver_x86_reports .text.unlikely.check_driver_x86_reports)
        */main_unit_checker/native.o(.text.check_driver_x86_reports .text.unlikely.check_driver_x86_reports)
        */main_unit_checker.c.o(.text.check_driver_return_reports .text.unlikely.check_driver_return_reports)
        */main_unit_checker/native.o(.text.check_driver_return_reports .text.unlikely.check_driver_return_reports)
        */main_unit_checker.c.o(.text.check_driver_flushed_bodies .text.unlikely.check_driver_flushed_bodies)
        */main_unit_checker/native.o(.text.check_driver_flushed_bodies .text.unlikely.check_driver_flushed_bodies)
        */main_unit_checker.c.o(.text.check_driver_common_warnings .text.unlikely.check_driver_common_warnings)
        */main_unit_checker/native.o(.text.check_driver_common_warnings .text.unlikely.check_driver_common_warnings)
        */main_unit_checker.c.o(.text.check_common_chained_comparisons .text.unlikely.check_common_chained_comparisons)
        */main_unit_checker/native.o(.text.check_common_chained_comparisons .text.unlikely.check_common_chained_comparisons)
        */main_unit_checker.c.o(.text.check_common_shift_finish .text.unlikely.check_common_shift_finish)
        */main_unit_checker/native.o(.text.check_common_shift_finish .text.unlikely.check_common_shift_finish)
        */main_unit_checker.c.o(.text.check_driver_target_features .text.unlikely.check_driver_target_features)
        */main_unit_checker/native.o(.text.check_driver_target_features .text.unlikely.check_driver_target_features)
        */main_unit_checker.c.o(.text.check_driver_aliases .text.unlikely.check_driver_aliases)
        */main_unit_checker/native.o(.text.check_driver_aliases .text.unlikely.check_driver_aliases)
        */main_unit_checker.c.o(.text.check_driver_object .text.unlikely.check_driver_object)
        */main_unit_checker/native.o(.text.check_driver_object .text.unlikely.check_driver_object)
        */main_unit_checker.c.o(.text.check_driver_reports_from .text.unlikely.check_driver_reports_from)
        */main_unit_checker/native.o(.text.check_driver_reports_from .text.unlikely.check_driver_reports_from)
        */main_unit_checker.c.o(.text.check_common_empty_bodies .text.unlikely.check_common_empty_bodies)
        */main_unit_checker/native.o(.text.check_common_empty_bodies .text.unlikely.check_common_empty_bodies)
        */main_unit_checker.c.o(.text.check_common_graph_warnings .text.unlikely.check_common_graph_warnings)
        */main_unit_checker/native.o(.text.check_common_graph_warnings .text.unlikely.check_common_graph_warnings)
        */main_unit_checker.c.o(.text.check_common_own_reach .text.unlikely.check_common_own_reach)
        */main_unit_checker/native.o(.text.check_common_own_reach .text.unlikely.check_common_own_reach)
        */main_unit_checker.c.o(.text.check_common_parents .text.unlikely.check_common_parents)
        */main_unit_checker/native.o(.text.check_common_parents .text.unlikely.check_common_parents)
        */main_unit_checker.c.o(.text.check_common_constant_changes .text.unlikely.check_common_constant_changes)
        */main_unit_checker/native.o(.text.check_common_constant_changes .text.unlikely.check_common_constant_changes)
        */main_unit_checker.c.o(.text.check_common_unreachable .text.unlikely.check_common_unreachable)
        */main_unit_checker/native.o(.text.check_common_unreachable .text.unlikely.check_common_unreachable)
        */main_unit_checker.c.o(.text.check_common_unselected_roots .text.unlikely.check_common_unselected_roots)
        */main_unit_checker/native.o(.text.check_common_unselected_roots .text.unlikely.check_common_unselected_roots)
        */main_unit_checker.c.o(.text.check_common_body_reached .text.unlikely.check_common_body_reached)
        */main_unit_checker/native.o(.text.check_common_body_reached .text.unlikely.check_common_body_reached)
        */main_unit_checker.c.o(.text.check_common_ignored_prepare .text.unlikely.check_common_ignored_prepare)
        */main_unit_checker/native.o(.text.check_common_ignored_prepare .text.unlikely.check_common_ignored_prepare)
        */main_unit_checker.c.o(.text.check_common_root_order_next .text.unlikely.check_common_root_order_next)
        */main_unit_checker/native.o(.text.check_common_root_order_next .text.unlikely.check_common_root_order_next)
        */main_unit_checker.c.o(.text.check_common_ignored_statement .text.unlikely.check_common_ignored_statement)
        */main_unit_checker/native.o(.text.check_common_ignored_statement .text.unlikely.check_common_ignored_statement)
        */main_unit_checker.c.o(.text.check_common_ignored_of .text.unlikely.check_common_ignored_of)
        */main_unit_checker/native.o(.text.check_common_ignored_of .text.unlikely.check_common_ignored_of)
        */main_unit_checker.c.o(.text.check_common_ignored_builtin .text.unlikely.check_common_ignored_builtin)
        */main_unit_checker/native.o(.text.check_common_ignored_builtin .text.unlikely.check_common_ignored_builtin)
        */main_unit_checker.c.o(.text.check_common_format_argument_type .text.unlikely.check_common_format_argument_type)
        */main_unit_checker/native.o(.text.check_common_format_argument_type .text.unlikely.check_common_format_argument_type)
        */main_unit_checker.c.o(.text.check_common_format_integer_class .text.unlikely.check_common_format_integer_class)
        */main_unit_checker/native.o(.text.check_common_format_integer_class .text.unlikely.check_common_format_integer_class)
        */main_unit_checker.c.o(.text.check_program_sections .text.unlikely.check_program_sections)
        */main_unit_checker/native.o(.text.check_program_sections .text.unlikely.check_program_sections)
        */main_unit_checker.c.o(.text.check_driver_object_build .text.unlikely.check_driver_object_build)
        */main_unit_checker/native.o(.text.check_driver_object_build .text.unlikely.check_driver_object_build)
        */main_unit_checker.c.o(.text.check_program_lanes_release .text.unlikely.check_program_lanes_release)
        */main_unit_checker/native.o(.text.check_program_lanes_release .text.unlikely.check_program_lanes_release)
    }
}
INSERT BEFORE .text;
